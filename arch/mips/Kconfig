## arch/mips/Kconfig
```kconfig
# Kconfig - MIPS architecture configuration options

#
# Copyright (c) 2017 Actions Semiconductor Co., Ltd
#
# SPDX-License-Identifier: Apache-2.0
#

choice
	prompt "MIPS SoC Selection"
	default SOC_SERIES_WOODPECKERFPGA
	depends on MIPS

	source "arch/mips/soc/*/Kconfig.soc"
endchoice

menu "MIPS Options"
	depends on MIPS

config ARCH
	default "mips"

config ARCH_DEFCONFIG
	string
	default "arch/mips/defconfig"

config SRAM_SIZE
	int "SRAM Size in kB"
	help
	This option specifies the size of the SRAM in kB.  It is normally set by
	the board's defconfig file and the user should generally avoid modifying
	it via the menu configuration.

config CACHE_SIZE
	int "CACHE Size in kB"
	help
	This option specifies the size of the CACHE in kB.

config SRAM_BASE_ADDRESS
	hex "SRAM Base Address"
	help
	This option specifies the base address of the SRAM on the board.  It is
	normally set by the board's defconfig file and the user should generally
	avoid modifying it via the menu configuration.

config FLASH_SIZE
	int "Flash Size in kB"
	help
	This option specifies the size of the flash in kB.  It is normally set by
	the board's defconfig file and the user should generally avoid modifying
	it via the menu configuration.

config FLASH_BASE_ADDRESS
	hex "Flash Base Address"
	help
	This option specifies the base address of the flash on the board.  It is
	normally set by the board's defconfig file and the user should generally
	avoid modifying it via the menu configuration.

source "arch/mips/core/Kconfig"

menu "Board Configuration"

source "arch/mips/soc/*/Kconfig"

endmenu
endmenu
```

## arch/mips/core/Kconfig
```kconfig
# Kconfig - MIPS core configuration options

#
# Copyright (c) 2017 Actions Semiconductor Co., Ltd
#
# SPDX-License-Identifier: Apache-2.0
#

config CPU_MIPS_M4K
	bool
	# Omit prompt to signify "hidden" option
	default n
	select ATOMIC_OPERATIONS_C
	help
	This option signifies the use of a CPU of the MIPS M4K family.

config USE_MIPS16E
	bool "Compile to mips16e instruction"
	depends on MIPS
	default n
	help
	  Compile to mips16e instruction to shrink code size.

config EXTRA_EXCEPTION_INFO
	bool "Extra exception debug information"
	default n
	help
	Have exceptions print additional useful debugging information in
	human-readable form, at the expense of code size. For example,
	the cause code for an exception will be supplemented by a string
	describing what that cause code means.

config STACK_BACKTRACE
	bool "Enable stack backtrace"
	depends on MIPS
	default n
	select KALLSYMS
	select THREAD_STACK_INFO
	help
	  Support dump stack backtrace by kallsyms.

	  If you say Y here the resulting kernel image will be slightly larger
	  but not slower, and it will give very useful debugging information.
	  If you don't debug the kernel, you can say N, but we may not be able
	  to solve problems without frame unwind information

config STACK_MONITOR
	bool "Enable stack usage monitor"
	depends on MIPS
	default n
	select THREAD_STACK_INFO
	help
	  Support stack usage monitor. The kernel will check the thread stack
	  usage at the entry of interrupt.

config STACK_MONITOR_WARN_THRESHOLD
	int "The warning threshold of free stack size"
	depends on STACK_MONITOR
	default 64
	help
	  Config the warning threshold of free stack size.

config STACK_MONITOR_PARANOID
	bool "Check stack usage more paranoid"
	depends on STACK_MONITOR && INIT_STACKS
	default n
	help
	  Check stack usage by comparing with stack initial magic data

config IRQ_STAT
	bool "Collect IRQ statistics"
	depends on MIPS && GEN_SW_ISR_TABLE
	default y
	help
	 Collect IRQ statistics, such as IRQ count, the maximum running cycles of IRQ.

config IRQ_PRIO_HIGHEST
    int
    depends on CPU_MIPS_M4K
    default 0
    help
       IRQ priority highest

config IRQ_PRIO_HIGH
    int
    depends on CPU_MIPS_M4K
    default 1
    help
       IRQ priority high

config IRQ_PRIO_NORMAL
    int
    depends on CPU_MIPS_M4K
    default 2
    help
       IRQ priority normal

config IRQ_PRIO_LOW
    int
    depends on CPU_MIPS_M4K
    default 3
    help
       IRQ priority low

config SYS_IRQ_LOCK
    bool "Lock irq by VIC interface"
    depends on CPU_MIPS_M4K
    default n
    help
      Lock irq by VIC interface. Some special IRQ (e.g. bluetooth controller)
      still can be proccessed when using sys irq lock.

config SYS_IRQ_LOCK_EXCEPT_BT_CON
    bool "Lock irq except bluetooth controller IRQ"
    depends on SYS_IRQ_LOCK
    default n
    help
      Lock irq except bluetooth controller IRQ.
```

## arch/mips/soc/actions/woodpecker/Kconfig.defconfig.ats2853
```kconfig
# Kconfig - Actions Bluetooth SoC platform configuration options

#
# Copyright (c) 2018 Actions Semiconductor Co., Ltd
#
# SPDX-License-Identifier: Apache-2.0
#

if SOC_ATS2853

config SOC
	string
	default ats2853
	

endif # SOC_ATS2853
```

## arch/mips/soc/actions/woodpecker/Kconfig.defconfig.ats2855
```kconfig
# Kconfig - Actions Bluetooth SoC platform configuration options

#
# Copyright (c) 2018 Actions Semiconductor Co., Ltd
#
# SPDX-License-Identifier: Apache-2.0
#

if SOC_ATS2855

config SOC
	string
	default ats2855

endif # SOC_ATS2855
```

## arch/mips/soc/actions/woodpecker/Kconfig.defconfig.ats2859
```kconfig
# Kconfig - Actions Bluetooth SoC platform configuration options

#
# Copyright (c) 2018 Actions Semiconductor Co., Ltd
#
# SPDX-License-Identifier: Apache-2.0
#

if SOC_ATS2859

config SOC
	string
	default ats2859
	

endif # SOC_ATS2859
```

## arch/mips/soc/actions/woodpecker/Kconfig.defconfig.series
```kconfig
# Kconfig - Actions Bluetooth SoC platform configuration options

#
# Copyright (c) 2018 Actions Semiconductor Co., Ltd
#
# SPDX-License-Identifier: Apache-2.0
#

if SOC_SERIES_WOODPECKER

config SOC_SERIES
	default woodpecker

config GEN_ISR_TABLES
	default y

config GEN_IRQ_VECTOR_TABLE
	default n

config ISR_STACK_SIZE
	default 1024

config IDLE_STACK_SIZE
	default 512

config EXTRA_EXCEPTION_INFO
	default y

config SRAM_BASE_ADDRESS
	default 0xbfc21000

config SRAM_SIZE
	int "SRAM size (kbytes)"
	default 172

config CACHE_SIZE
	int "CACHE size (kbytes)"
	default 32

config FLASH_BASE_ADDRESS
	default 0xbf000000

config FLASH_SIZE
	default 1200

config TEXT_SECTION_OFFSET
	default 0x400

config BOOTLOADER_SRAM_SIZE
	default 0

config XIP
	default y

config NUM_IRQS
	int
	default 42

config NUM_IRQ_PRIO_BITS
	int
	default 3

config SYS_CLOCK_TICKS_PER_SEC
	int
	default 100

config SYS_CLOCK_HW_CYCLES_PER_SEC
	int
	default 24000000

config SOC_CPU_CLK_FREQ
	default 216000

config SOC_DSP_CLK_FREQ
	default 396000

config SOC_VDD_VOLTAGE
	default 1250

config BUSY_WAIT_USES_ALTERNATE_CLOCK
	default y

config ROM_XSPI_WRITE_DATA_PATCH
	default y

config ACTS_TIMER
	default y

if SOC_MAPPING_PSRAM
config SOC_MAPPING_PSRAM_ADDR
	default 0xbe800000

config SOC_MAPPING_PSRAM_SIZE
	default 0x200000

endif #SOC_MAPPING_PSRAM

if ADC

config ADC_ACTS
	def_bool y

endif # ADC

if GPIO

config GPIO_ACTS
	def_bool y

endif # GPIO

if I2C

config I2C_ACTS
	def_bool y

endif # I2C

if PWM

config PWM_ACTS
	def_bool y

endif # PWM

config SPI
	def_bool n

if SPI

config SPI_ACTS
	def_bool y

config SPI_1_ACTS_DELAY_CHAIN
	default 6

endif # SPI

if XSPI_NOR_ACTS

config XSPI_NOR_ACTS_DELAY_CHAIN
	default 6

endif # XSPI_NOR_ACTS

if SERIAL

config UART_ACTS
	def_bool y

endif # SERIAL

if MMC_0

config MMC_0_DATA_REG_WIDTH
	default 1

endif # MMC_0

if MMC_1

config MMC_1_DATA_REG_WIDTH
	default 1

endif # MMC_1

source "arch/mips/soc/actions/woodpecker/Kconfig.defconfig.ats*"

endif # SOC_SERIES_WOODPECKER
```

## arch/mips/soc/actions/woodpecker/Kconfig.series
```kconfig
# Kconfig - Actions Bluetooth SoC configuration options

#
# Copyright (c) 2018 Actions Semiconductor Co., Ltd
#
# SPDX-License-Identifier: Apache-2.0
#

config  SOC_SERIES_WOODPECKER
	bool "Actions Woodpecker MIPS Bluetooth Series SoC"
	select CPU_MIPS_M4K
	select SOC_FAMILY_ACTS
	help
	 Enable support for Actions Woodpecker MIPS Bluetooth Series SoC
```

## arch/mips/soc/actions/woodpecker/Kconfig.soc
```kconfig
# Kconfig - Actions Bluetooth SoC configuration options

#
# Copyright (c) 2018 Actions Semiconductor Co., Ltd
#
# SPDX-License-Identifier: Apache-2.0
#

choice
	prompt "Actions Woodpecker Bluetooth SoC"
	depends on SOC_SERIES_WOODPECKER

source "arch/mips/soc/actions/woodpecker/Kconfig.soc.*"

endchoice

if SOC_SERIES_WOODPECKER

config SOC_DSP_CLK_FREQ
	int "DSP clock frequence (KHz)"
	range 30000 400000
	help
	  config Actions SoC DSP clock frequence (KHz)

config SOC_CPU_CLK_FREQ
	int "CPU clock frequence (KHz)"
	range 30000 216000
	help
	  config Actions SoC CPU clock frequence (KHz)

config SOC_VDD_VOLTAGE
	int "VDD Voltage (mV)"
	range 800 1500
	help
	  VDD Voltage (mV) 

config SOC_MAPPING_PSRAM
	bool "enable PSRAM mapping"
	default n
	help
	  Enable SPI cache profile for Andes SoC

if SOC_MAPPING_PSRAM
config SOC_MAPPING_PSRAM_ADDR
	hex "PSRAM mapping space base address"
	default 0
	help
	  PSRAM mapping space base address

config SOC_MAPPING_PSRAM_SIZE
	hex "PSRAM mapping space size"
	default 0
	help
	  PSRAM mapping space size

config SOC_MAPPING_PSRAM_FOR_OS
	bool "enable PSRAM mapping for OS"
	default n
	help
	  Enable PSRAM mapping for OS
endif

config HOSC_CLK_MHZ
    int 
    default 24
    help
      config Actions SoC hosc frequency

config SOC_SPREAD_SPECTRUM
    bool "enable SOC spread spectrum"
    default y
    help
      enable SOC spread spectrum

config ESD_SUPPORT
    bool "support ESD"
    default y    
    help
      config Actions SoC support ESD  

config IDLE_CLOSE_CPU_CLK
    bool "close cpu clock when cpu is idle"
    default n
    help
        config close cpu clock when cpu excecute wait instuction

config CPU0_EJTAG_ENABLE
    bool "enable cpu0 ejtag or not"
    default n
    help
      config cpu0 ejtag enable

config CPU0_EJTAG_GROUP
    int "CPU0 EJTAG group select"
    default 0
    help
      config cpu0 ejtag group

config CPU0_PANIC_EJTAG_ENABLE
    bool "CPU0 EJTAG group select when panic"
    default n
    help
      config cpu0 ejtag group when panic

config DSP_EJTAG_ENABLE
    bool "enable dsp ejtag or not"
    default n
    help
      config dsp ejtag enable    
      
config DSP_EJTAG_GROUP
    int "DSP EJTAG group select"
    default 0
    depends on DSP_EJTAG_ENABLE
    help
      config dsp ejtag group                  

config SOC_SPI_USE_COREPLL
    bool "enable cpu spi use corepll clock source "
    default n
    help
      enable cpu spi use corepll clock source  
         
config SOC_SPI_USE_SPLL
    bool "enable cpu spi use spll clock source "
    default y
    help
      enable cpu spi use corepll clock source  

config PM_SLEEP_TIME_TRACE
    bool "Enable s3bt and s2 time trace"
    default n
    help
      Enable s3bt and s2 time trace

menu "SOC wakeup source"
config SOC_WKEN_DC5V
	bool "enable plug in 5v adapter to wakeup system"
	default y
	help
	  Enable plug in 5v adapter to wakeup system

config SOC_WKEN_BAT
	bool "enable plug in battery to wakeup system"
	default n
	help
	  Enable plug in battery to wakeup system

config SOC_WKEN_ONOFF_SHORT
	bool "enable short press onoff to wakeup system"
	default n
	help
	  Enable short press onoff to wakeup system

config SOC_WKEN_ONOFF_LONG_PRESS_TIMER
	int "config long press onoff time MS to wake up system"
	default 1000
	help
	  Config long press onoff time MS to wake up system
endmenu

menu "SOC Power Mangerment"

config PM_CPU_IDLE_LOW_POWER
	bool "enable cpu to low power when idle"
	default n
	help
	  Decease cpu frequence to when cpu is in idle state

config PM_CPU_IDLE_FREQ_KHZ
	int "cpu frequence in idle state (KHz)"
	depends on PM_CPU_IDLE_LOW_POWER
	range 10000 180000
	default 30000
	help
	  Reduce cpu frequence to save power consume when cpu is in idle state
endmenu

endif
source "arch/mips/soc/actions/woodpecker/rom_config/Kconfig"
```

## arch/mips/soc/actions/woodpecker/rom_wrapper/Kconfig
```kconfig
# Kconfig - Actions Bluetooth SoC platform configuration options

#
# Copyright (c) 2018 Actions Semiconductor Co., Ltd
#
# SPDX-License-Identifier: Apache-2.0
#

config USE_ROM
    bool
    default y

config ROM_TABLE_ENTRY_ADDR
    int
    default 656
```
