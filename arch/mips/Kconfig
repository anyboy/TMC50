## boards/mips/ats2859_dvb/ats2859_dvb_defconfig
```kconfig
CONFIG_MIPS=y
CONFIG_USE_MIPS16E=y
CONFIG_BOARD_ATS2859_DVB=y
CONFIG_BOARD="ATS2859_dvb"
CONFIG_SOC_FAMILY_ACTIONS=y
CONFIG_SOC_SERIES_WOODPECKER=y
CONFIG_SOC_ATS2859=y
CONFIG_ACTS_TIMER=y
CONFIG_ACTS_HRTIMER=y
CONFIG_CONSOLE=y
CONFIG_UART_CONSOLE=y
CONFIG_EARLY_CONSOLE=y
CONFIG_STDOUT_CONSOLE=y
CONFIG_UART_CONSOLE_ON_DEV_NAME="UART_0"

CONFIG_SERIAL=y
CONFIG_UART_ACTS=y
CONFIG_UART_INTERRUPT_DRIVEN=y
CONFIG_UART_ACTS_PORT_0=y
CONFIG_UART_ACTS_PORT_0_NAME="UART_0"
#CONFIG_UART_ACTS_PORT_0_BAUD_RATE=921600
CONFIG_UART_ACTS_PORT_0_BAUD_RATE=115200
CONFIG_UART_ACTS_PORT_0_PRIORITY=0
CONFIG_UART_ACTS_PORT_1=y
CONFIG_UART_ACTS_PORT_1_NAME="UART_1"
CONFIG_UART_ACTS_PORT_1_BAUD_RATE=115200
CONFIG_UART_ACTS_PORT_1_PRIORITY=0

#uart config
CONFIG_UART_TX_DMA=6
CONFIG_UART_TX_PIN=23
CONFIG_UART_RX_PIN=16
CONFIG_UART_BR=115200
CONFIG_UART_CONSOLE_DMA_SUPPORT=y
CONFIG_UART_CONSOLE_DMA_CHANNEL=1

#uart pipe
CONFIG_UART_PIPE=y
CONFIG_UART_PIPE_ON_DEV_NAME="UART_1"

CONFIG_FLASH=y
CONFIG_FLASH_SIZE=2048
CONFIG_SPI_PSRAM=n
CONFIG_XSPI_NOR_ACTS=y
CONFIG_XSPI_PSRAM_ACTS=n
CONFIG_XSPI_NOR_ACTS_DEV_NAME="xspi_nor"
CONFIG_XSPI_NOR_ACTS_IO_BUS_WIDTH=4
CONFIG_XSPI_NOR_ACTS_DATA_PROTECTION_ENABLE=n
CONFIG_XSPI_NOR_ACTS_DEV_INIT_PRIORITY=45
CONFIG_XSPI_NOR_ACTS_DEV_TEST_DELAYCHAIN_PRIORITY=58
CONFIG_XSPI_NOR_ACTS_DUMP_INFO=y
CONFIG_XSPI_MEM_ACTS=y
CONFIG_XSPI_NOR_ROM_ACTS=n
CONFIG_XSPI_NOR_AUTO_CHECK_RB=n
CONFIG_XSPI_ACTS_FREQ_MHZ=90
CONFIG_XSPI_NOR_ACTS_DELAY_CHAIN=8
CONFIG_SOC_SPI_USE_SPLL=n
CONFIG_SOC_SPI_USE_COREPLL=y
CONFIG_XSPI1_NOR_ACTS=n
CONFIG_XSPI1_ACTS_FREQ_MHZ=48
CONFIG_XSPI1_ACTS_USE_DMA=y
CONFIG_XSPI0_USE_COREPLL=n
CONFIG_XSPI1_USE_COREPLL=n
CONFIG_XSPI2_USE_COREPLL=n

CONFIG_SPI=n
CONFIG_SPI_1=n
CONFIG_SPI_ACTS=n
CONFIG_SPI_LEGACY_API=n
CONFIG_SPI_1_ACTS_DELAY_CHAIN=8

CONFIG_NVRAM_CONFIG=y
CONFIG_NVRAM_STORAGE_FLASH=y
CONFIG_NVRAM_STORAGE_DEV_NAME="xspi_nor"
CONFIG_NVRAM_FACTORY_REGION_SEGMENT_SIZE=0x1000
CONFIG_NVRAM_STORAGE_FACTORY_RW_REGION=y
CONFIG_NVRAM_FACTORY_RW_REGION_SEGMENT_SIZE=0x1000
CONFIG_NVRAM_USER_REGION_SEGMENT_SIZE=0x1000
CONFIG_NVRAM_CAHCE=y

CONFIG_GPIO=y
CONFIG_GPIO_ACTS=y
CONFIG_GPIO_ACTS_DEV_NAME="GPIO_0"
CONFIG_GPIO_WIO_ACTS=y
CONFIG_GPIO_WIO_ACTS_DEV_NAME="WIO"

CONFIG_DMA=y
CONFIG_DMA_ACTS_WOODPECKER=n
CONFIG_VDMA_ACTS_WOODPECKER=y

CONFIG_RANDOM_GENERATOR=y
CONFIG_RANDOM_ACTS_TRNG=y

CONFIG_ADC=y
CONFIG_ADC_ACTS=y

CONFIG_INPUT_DEV=y
CONFIG_INPUT_DEV_ACTS_ADCKEY=y
CONFIG_INPUT_DEV_ACTS_ADCKEY_ADC_CHAN=4
CONFIG_INPUT_DEV_ACTS_ONOFF_KEY=y
CONFIG_PWM=y
CONFIG_PWM_ACTS=y

CONFIG_I2C=y
CONFIG_I2C_ACTS=y
CONFIG_I2C_1=y
CONFIG_I2C_1_IRQ_PRI=2

CONFIG_I2C_SLAVE=n
CONFIG_I2C_SLAVE_0=n
CONFIG_I2C_SLAVE_ACTS=n
CONFIG_I2C_SLAVE_0_SCL_PIN=0
#- 0 - 19- 30- 42
CONFIG_I2C_SLAVE_0_SDA_PIN=1
#- 1 - 19- 29- 43

CONFIG_CPU0_EJTAG_ENABLE=n
CONFIG_CPU0_EJTAG_GROUP=3
CONFIG_CPU0_PANIC_EJTAG_ENABLE=y

CONFIG_HOTPLUG_LINEIN_DETECT=y
CONFIG_HOTPLUG_LINEIN_DETECT_ADC_CHAN=4
CONFIG_HOTPLUG_DC5V_DETECT=y
CONFIG_HOTPLUG_DC5V_WIO=1
CONFIG_HOTPLUG_DC5V_LEVEL=1

CONFIG_MMC=y
CONFIG_MMC_0=y
CONFIG_MMC_0_DEVICE_NAME="MMC_0"
CONFIG_MMC_0_IO_WIDTH=1
CONFIG_MMC_0_ACTS_DMA_CHAN=-1
CONFIG_MMC_SDCARD=y
CONFIG_MMC_SDCARD_MMC_DEV_NAME="MMC_0"
CONFIG_MMC_ACTS=y
CONFIG_MMC_ACTS_DMA=y

CONFIG_MPU_MONITOR_RAMFUNC_WRITE=y

CONFIG_POWER_SUPPLY=y
CONFIG_POWER_SUPPLY_ACTS_BATTERY=y
CONFIG_BATTERY_ACTS_ADC_NAME="ADC_0"
CONFIG_BATTERY_ACTS_ADC_CHAN=0
CONFIG_BATTERY_CAP_CTRL=n

#蓝牙频偏配置
CONFIG_COMPENSATION=y
CONFIG_COMPENSATION_ACTS=y
CONFIG_TEMP_COMPENSATION_ACTS=n
CONFIG_COMPENSATION_DEFAULT_HOSC_CAP=119
CONFIG_COMPENSATION_HOSC_CAP_NVRAM_PRIORITY=n

CONFIG_SOC_MAPPING_PSRAM=n
#CONFIG_SOC_MAPPING_PSRAM_ADDR=0xbe800000
#CONFIG_SOC_MAPPING_PSRAM_SIZE=0x200000
CONFIG_SOC_MAPPING_PSRAM_FOR_OS=n
CONFIG_SOC_PSRAM_DCACHE=n

#CONFIG_RAMFUNCTION_MEMORY=n

#disk config
CONFIG_DISK_ACCESS_SD=y
CONFIG_DISK_ACCESS_NOR=y
CONFIG_DISK_NOR_DEV_NAME="xspi_nor"
CONFIG_DISK_NOR_VOLUME_SIZE=0xc0000
CONFIG_DISK_NOR_START=0x120000
CONFIG_SD_FS=y
CONFIG_SD_FS_VADDR_START=0xbe800000

#audio config
CONFIG_AUDIO_OUT_I2STX0_SUPPORT=y

CONFIG_AUDIO_POWERON_OPEN_PA=y
CONFIG_BOARD_EXTERNAL_PA_ENABLE=n
# 0--classA/B; 1--classD
CONFIG_EXTERN_PA_CLASS=1

# RTC options
CONFIG_RTC=y
CONFIG_RTC_ACTS=y

# Timer Input Capture options
CONFIG_ACTS_TIMER3_CAPTURE=n

# SEG LED options
CONFIG_SEG_LED_DISPLAY=y

CONFIG_PCMBUF_HE_THRESHOLD=0x30
CONFIG_PCMBUF_HF_THRESHOLD=0x40

# USB controller
CONFIG_SYS_LOG_USB_OTG_DRIVER_LEVEL=3
CONFIG_USB_AOTG_OTG=y
CONFIG_USB_AOTG_OTG_VERSION=0x551A18CF
CONFIG_USB_AOTG_OTG_SUPPORT_HS=n

#FM type
CONFIG_FM_QN8035=n
CONFIG_FM_RDA5820=y
CONFIG_FM_EXT_24M=n
CONFIG_FM_TRANSMITTER=y

# IR options
CONFIG_INPUT_DEV_ACTS_IRKEY=n
CONFIG_INPUT_DEV_ACTS_IRKEY_POLL_USERCODE=y
CONFIG_INPUT_DEV_ACTS_IRKEY_CORRECT_USERCODE=n

# SPDIFRX options
CONFIG_AUDIO_IN_SPDIFRX_SUPPORT=n
CONFIG_AUDIO_IN_I2SRX0_SUPPORT=y
```

## drivers/accelerator/Kconfig
```kconfig
# Kconfig - Actions SoC Audio Accelerator configuration options
#
#
# Copyright (c) 2020 Actions Semiconductor Co., Ltd
#
# SPDX-License-Identifier: Apache-2.0
#

menuconfig ACCELERATOR_ACTS
	bool "Audio Accelerator driver for Actions SoC"
	default n
	depends on SOC_FAMILY_ACTS
	help
	Actions SoC audio accelerator driver.

config ACCELERATOR_ACTS_DEV_NAME
	string "Device Name for Actions SoC Audio Accelerator"
	default "audio_accelerator_acts"
	depends on ACCELERATOR_ACTS
	help
	Device name for Actions SoC Audio Accelerator.

config ACCELERATOR_ACTS_DEVICE_INIT_PRIORITY
	int "Audio Accelerator Device Init Priority"
	default 10
	depends on ACCELERATOR_ACTS
	help
	This option controls the priority of Audio Accelerator device initialization.
	Higher priority ensures that the device is initialized earlier
	in the startup cycle. If unsure, leave at default value.

	string "Device Name for Actions SoC Audio Accelerator"
	default 10
	depends on ACCELERATOR_ACTS
	help
	Device name for Actions SoC Audio Accelerator.

if ACCELERATOR_ACTS

source "drivers/accelerator/woodpecker/Kconfig"

endif # ACCELERATOR_ACTS
```

## drivers/accelerator/woodpecker/Kconfig
```kconfig
# Kconfig - Actions Woodpecker SoC Audio Accelerator configuration options
#
#
# Copyright (c) 2020 Actions Semiconductor Co., Ltd
#
# SPDX-License-Identifier: Apache-2.0
#

menuconfig ACCELERATOR_ACTS_WOODPECKER
	bool "Audio Accelerator driver for Actions Woodpecker SoC"
	default n
	depends on SOC_SERIES_WOODPECKER || SOC_SERIES_WOODPECKERFPGA
	help
	Actions Woodpecker SoC audio accelerator driver.
```

## drivers/audio/Kconfig
```kconfig
# Kconfig - Audio configuration options
#
#
# Copyright (c) 2017 Actions Semiconductor Co.,Ltd
#
# SPDX-License-Identifier: Apache-2.0
#

menuconfig AUDIO
	bool
	prompt "audio Drivers"
	default n
	help
	Enable options for audio drivers.

if AUDIO

config AUDIO_OUT_ACTS
	bool
	prompt "Actions SoC audio output driver"
	default n
	select AUDIO_OUT_ACTS_WOODPECKER
	help
	Device driver for Actions SoC audio output

config AUDIO_OUT_ACTS_ROCKY
	bool
	prompt "Actions SoC audio output driver for rocky"
	default n
	depends on SOC_SERIES_ROCKY
	help
	Device driver for Actions SoC audio output

config AUDIO_OUT_ACTS_ANDES
	bool
	prompt "Actions SoC audio output driver for andes"
	default n
	depends on SOC_SERIES_ANDESM || SOC_SERIES_ANDES && AUDIO_OUT_ACTS
	help
	Device driver for Actions SoC audio output

config AUDIO_OUT_ACTS_WOODPECKER
	bool
	prompt "Actions SoC audio output driver for woodpecker"
	default y
	depends on SOC_SERIES_WOODPECKER && AUDIO_OUT_ACTS
	help
	Device driver for Actions SoC audio output

config AUDIO_OUT_ACTS_DEV_NAME
	string "Device Name for Actions SoC audio output"
	default "audio_out"
	depends on AUDIO_OUT_ACTS
	help
	  This is the device name for audio output, and is included in the
	  device struct.

config AUDIO_OUT_DAC_SUPPORT
	bool
	prompt "enable DAC out or not"
	default y
	depends on AUDIO_OUT_ACTS
	help
	audio enable DAC out or not.

config AUDIO_OUT_I2STX0_SUPPORT
	bool
	prompt "enable i2s tx0 out or not"
	default n
	depends on AUDIO_OUT_ACTS
	help
	audio enable i2stx0 out or not.

config AUDIO_OUT_SPDIFTX_SUPPORT
	bool
	prompt "enable spdif tx out or not"
	default n
	depends on AUDIO_OUT_ACTS
	help
	audio enable spdif out or not.

config AUDIO_IN_ACTS
	bool
	prompt "Actions SoC audio input driver"
	default n
	select AUDIO_IN_ACTS_WOODPECKER
	help
	Device driver for Actions SoC audio input

config AUDIO_IN_ACTS_ROCKY
	bool
	prompt "Actions SoC audio input driver for rocky"
	default n
	depends on SOC_SERIES_ROCKY && AUDIO_IN_ACTS
	help
	Device driver for Actions SoC audio input

config AUDIO_IN_ACTS_ANDES
	bool
	prompt "Actions SoC audio input driver for andes"
	default n
	depends on SOC_SERIES_ANDESM || SOC_SERIES_ANDES && AUDIO_IN_ACTS
	help
	Device driver for Actions SoC audio input

config AUDIO_IN_ACTS_WOODPECKER
	bool
	prompt "Actions SoC audio input driver for woodpecker"
	default y
	depends on SOC_SERIES_WOODPECKER && AUDIO_IN_ACTS
	help
	Device driver for Actions SoC audio input

config AUDIO_IN_ACTS_DEV_NAME
	string "Device Name for Actions SoC audio input"
	default "audio_in"
	depends on AUDIO_IN_ACTS
	help
	  This is the device name for audio input, and is included in the
	  device struct.

config AUDIO_IN_ADC_SUPPORT
	bool
	prompt "enable ADC out or not"
	default y
	depends on AUDIO_IN_ACTS
	help
	audio enable ADC in or not.

config AUDIO_IN_I2SRX0_SUPPORT
	bool
	prompt "enable i2s rx0 in or not"
	default n
	depends on AUDIO_IN_ACTS
	help
	audio enable i2srx0 in or not.

config AUDIO_IN_I2SRX1_SUPPORT
	bool
	prompt "enable i2s rx1 in or not"
	default n
	depends on AUDIO_IN_ACTS
	help
	audio enable i2srx1 in or not.

config AUDIO_IN_SPDIFRX_SUPPORT
	bool
	prompt "enable spdif rx in or not"
	default n
	depends on AUDIO_IN_ACTS
	help
	audio enable spdif in or not.

config BOARD_EXTERNAL_PA_ENABLE
	bool
	prompt "enable external pa or not"
	default n
	help
	Enable external pa or not.

config EXTERN_PA_CLASS
	int "set external pa default class mode"
	depends on BOARD_EXTERNAL_PA_ENABLE
	default 1
	range 0 1
	help
	Set extern pa class mode, 0 for classAB, other value for classD.

config AUDIO_POWERON_OPEN_PA
	bool
	prompt "open PA when power on"
	depends on AUDIO_OUT_DAC_SUPPORT
	default y
	help
	Open PA when power on or not.

config AUDIO_POWERON_OPEN_I2STX
	bool
	prompt "open I2STX when power on"
	depends on AUDIO_OUT_I2STX0_SUPPORT
	default y
	help
	Open I2STX when power on or not.

config AUDIO_ASRC_ACTS_DEV_NAME
	string "Device Name for Actions SoC audio asrc"
	default "audio_asrc"
	help
	  This is the device name for audio asrc, and is included in the
	  device struct.

config AUDIO_DRV_SHELL
	bool "Acts audio driver shell support"
	depends on CONSOLE_SHELL
	default y
	help
	If you say Y here, you will get support for the actions audio driver shell.

config AUDIO_ACTS_UTILS
	bool "Acts audio driver utils support"
	depends on AUDIO_OUT_ACTS || AUDIO_IN_ACTS
	default y
	help
	If you say Y here, you will get support for the actions audio driver utils.

if AUDIO_OUT_ACTS_WOODPECKER || AUDIO_IN_ACTS_WOODPECKER
source "drivers/audio/phy_woodpecker/Kconfig"
endif

endif # AUDIO
```
