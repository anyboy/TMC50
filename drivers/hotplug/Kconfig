## ext/actions/component/system/Kconfig
```kconfig
# Kconfig - Actions system manager

#
# Copyright (c) 2016 Actions Corporation
#
# SPDX-License-Identifier: Apache-2.0
#

menuconfig SYSTEM
	bool
	prompt "System"
	depends on ACTIONS_COMPONENT_FUNCTION
	select APP_MANAGER
	select SRV_MANAGER
	select MSG_MANAGER
	select MEMORY
	default y
	help
	This option enables actions system manager.

config APP_MANAGER
	bool
	prompt "App Manager Support"
	depends on SYSTEM
	default n
	help
	This option enables actions app manager.

config SRV_MANAGER
	bool
	prompt "Server Manager Support"
	depends on SYSTEM
	default n
	help
	This option enables actions server manager.

config MSG_MANAGER
	bool
	prompt "Message Manager Support"
	depends on SYSTEM
	default n
	help
	This option enables actions message manager.

config ESD_MANAGER
	bool
	prompt "Esd Manager Support"
	depends on SYSTEM
	default n
	help
	This option enables actions esd manager.

config SYS_STANDBY
	bool
	prompt "System Standby Support "
	depends on SYSTEM
	select SYS_WAKELOCK
	select PM_CPU_IDLE_LOW_POWER
	default n
	help
	This option enables actions system standby.

config SYS_WAKELOCK
	bool
	prompt "System Wake Lock Support "
	depends on SYSTEM
	depends on SYS_STANDBY
	default n
	help
	This option enables actions system wake lock.

config AUTO_STANDBY_TIME_SEC
    int "delay how long (second) to enter standby"
    depends on SYS_STANDBY
    default 0
    help
    This option set the time to enter standby when system idle

config AUTO_STANDBY_S2_LOWFREQ
    bool "auto standby enter S2, cpu run in low freq(32KHz)"
    depends on SYS_STANDBY
    default n
    help
    This option set auto standby enter S2, cpu run in low freq(32KHz)

config AUTO_POWEDOWN_TIME_SEC
    int "delay how long (second) to auto power down"
    depends on SYS_STANDBY
	default 1800
    help
    This option set the time to enter auto power down

config AUTO_POWEDOWN_UNCONNECTED
    bool 
    prompt "Poweroff When No Device Connected Support"
	depends on SYSTEM
    help
        allow poweroff when no device connected

config AUTO_POWEDOWN_NOPLAYING
    bool
    prompt "Poweroff When Not Playing Support"
	depends on SYSTEM
    help
        allow poweroff when not playing   

config MONITOR_PERIOD
    int "delay how long (second) to monitor running"
	depends on SYSTEM
	default 100
    help
    This option set the time to monitor running

config SYSTEM_SHELL
	bool "System Shell Support"
	depends on SYSTEM
	default n
	select CONSOLE_SHELL
	help
	  This shell provides to  modify system config.
```

## ext/actions/library/Kconfig
```kconfig
# Kconfig - Actions library

#
# Copyright (c) 2016 Actions Corporation
#
# SPDX-License-Identifier: Apache-2.0
#

menuconfig ACTIONS_LIBRARY
	bool
	prompt "Actions Library Support"
	depends on ACTIONS_SDK
	default n
	help
	  This option enables the Actions library .

menuconfig BT_STACK
	bool
	prompt "Blutooth Stack Support"
	depends on ACTIONS_LIBRARY
	default n
	select BT
	select BT_ACTIONS
	help
	This option enables actions Blutooth Stack.

menuconfig BT_SERVICE
	bool
	prompt "Blutooth Service Support"
	depends on ACTIONS_LIBRARY && THREAD_TIMER
	default n
	select BT
	select BT_ACTIONS
	help
	This option enables actions Blutooth service.

config BT_TWS_US281B
    bool
    prompt "Whether adaptive to us281b tws"
    default n
    depends on BT_SERVICE
    help
    This option set whether adaptive to us281b tws

config BTSRV_PRIORITY
    int
    prompt "Bt Service Thread Priority"
    default 4
    depends on BT_SERVICE
    help
    This option set audio thread priority  

config BTSRV_STACKSIZE
    int
    prompt "Bt Service Thread Stack Size"
    depends on BT_SERVICE
    default 2048
    help
    This option set stack size for bt service thread 

menuconfig AUDIO_SYSTEM
	bool
	prompt "audio system Support"
	depends on ACTIONS_LIBRARY && THREAD_TIMER
	default n
	select AUDIO
	select AUDIO_IN
	select AUDIO_OUT
	help
	This option enables actions media service. 	
	
menuconfig MEDIA_SERVICE
	bool
	prompt "Media Service Support"
	depends on ACTIONS_LIBRARY && THREAD_TIMER
	default n
	select AUDIO_SYSTEM
	select ACTIONS_ALGORITHMS_LIBRARY
	help
	This option enables actions media service.

config MEDIASRV_PRIORITY
    int
    prompt "Media Service Thread Priority"
    default 4
    depends on MEDIA_SERVICE
    help
    This option set audio thread priority  

config MEDIASRV_STACKSIZE
    int
    prompt "Media Service Thread Stack Size"
    default 2048
    depends on MEDIA_SERVICE
    help
    This option set stack size for audio service thread	    

source "ext/actions/library/mips/Kconfig"
```

## ext/actions/porting/hal/bluetooth/bt_drv/Kconfig
```kconfig
# Kconfig - ACTIONS primitive options for sdk version 2.0

#
# Copyright (c) 2015 Intel Corporation
#
# Licensed under the Apache License, Version 2.0 (the "License");
# you may not use this file except in compliance with the License.
# You may obtain a copy of the License at
#
#     http://www.apache.org/licenses/LICENSE-2.0
#
# Unless required by applicable law or agreed to in writing, software
# distributed under the License is distributed on an "AS IS" BASIS,
# WITHOUT WARRANTIES OR CONDITIONS OF ANY KIND, either express or implied.
# See the License for the specific language governing permissions and
# limitations under the License.
#

config BT_DRV_WOODPECKER_PHOENIX
    bool
    prompt "Actions Bluetooth controller driver (Phoenix) for Woodpecker SoC"
	depends on BT_DRV
    depends on SOC_SERIES_WOODPECKER || SOC_SERIES_WOODPECKERFPGA
	select COMPENSATION_ACTS
    default n
    help
    This option enables Actions Bluetooth controller Woodpecker SoC.

config BT_CONTROLER_DEBUG_PRINT
    bool
    prompt "Actions controler debug print"
	depends on BT_DRV
    default y
    help
    This option enables Actions controler debug print

config BT_CONTROLER_DEBUG_GPIO
    bool
    prompt "Actions controler debug gpio pin"
	depends on BT_DRV
    default n
    help
    This option enables Actions controler debug gpio pin

config BT_CONTROLER_MAX_TXPOWER
    int
    prompt "Bluetooth Controller Max TX power (unit: 0.1 db)"
    depends on BT_DRV
    default 80
    help
    This option config Bluetooth Controller Max TX power (unit: 0.1 db)

config BT_HCI_RX_PRINT
    bool    
    prompt "Actions Bluetooth hci RX Print"
	depends on BT_DRV
    depends on SOC_SERIES_ANDES || SOC_SERIES_ANDESM
    default n
    help
    This option enables Actions Bluetooth controller Andes RX Print
    
config BT_HCI_TX_PRINT
    bool    
    prompt "Actions Bluetooth hci TX Print"
	depends on BT_DRV
    depends on SOC_SERIES_ANDES || SOC_SERIES_ANDESM
    default n
    help
    This option enables Actions Bluetooth controller Andes TX Print   

config BT_CONTROLER_BQB
    bool    
    prompt "Actions Bluetooth Controller BQB test"
	depends on BT_DRV
    depends on SOC_SERIES_ANDES || SOC_SERIES_ANDESM || SOC_SERIES_WOODPECKER
    default n
    help
    This option enables Actions Bluetooth Controller BQB test   

config BT_CONTROLER_BLE_BQB
    bool    
    prompt "Actions Bluetooth Controller BQB ble test"
    depends on BT_DRV
    depends on SOC_SERIES_ANDES || SOC_SERIES_ANDESM || SOC_SERIES_WOODPECKER
    depends on BT_CONTROLER_BQB
    default n
    help
    This option enables Actions Bluetooth Controller ble BQB test

config BT_BQB_UART_PORT
	int "UART port id for BQB mode, and FCC mode"
	depends on BT_CONTROLER_BLE_BQB
	range [0 1]
	default 1
	help
	This option config UART port id for BQB mode, and FCC mode

config BT_CONTROLER_RF_FCC
    bool    
    prompt "Actions Bluetooth Controller RF FCC test"
    depends on SOC_SERIES_WOODPECKER
    default n
    help
    This option enables Actions Bluetooth Controller RF FCC test

config BT_FCC_UART_PORT
	int "UART port id for FCC mode"
	depends on BT_CONTROLER_RF_FCC
	range [0 1]
	default 1
	help
	This option config UART port id for FCC mode
```

## kernel/memory/Kconfig
```kconfig
menu "Memory Heap Options"

config POOL_PAGE_SHIFT
        int
        prompt "page size shift in page pools, options:9 ~ 12"
        default 11
        range 9 12
        help
        This option set page size in page pools

config  MEMORY_ANALYSIS
        bool
        prompt "enable statistic heap alloc information"
        default n
        help
        This option enables statistic heap alloc information
endmenu
```

## lib/memory/Kconfig
```kconfig
# Kconfig - Actions app function

#
# Copyright (c) 2016 Actions Corporation
#
# SPDX-License-Identifier: Apache-2.0
#
       
source "lib/memory/source/Kconfig"
```

## lib/utils/Kconfig
```kconfig
menuconfig ACTIONS_UTILS
    bool
    prompt "Actions Utils Support"
    default y
    help
    This option enables the actions test service. 
    
menuconfig ACTIONS_TRACE
    bool
    prompt "Actions Trace Support"
    depends on ACTIONS_UTILS
    default n
    help
    This option enables the actions trace service.
    
config TRACE_UART                               
    bool
    prompt "Actions Trace Uart Support"
    depends on ACTIONS_TRACE
    default y
   
config TRACE_FILE                               
    bool
    prompt "actions trace file Support"
    depends on ACTIONS_TRACE
    default n    
    
config TRACE_CONTEXT_SHELLTASK                               
    bool
    prompt "trace output context by shell thread or not"
    depends on ACTIONS_TRACE
    default n    
    
config TRACE_EVENT                               
    bool
    prompt "trace system event"
    depends on ACTIONS_TRACE
    default n
    
config TRACE_EVENT_BUFFERSIZE
    int 
    prompt "trace event buffer size"
    depends on TRACE_EVENT
    default 4096  
    
config TRACE_PERF_ENABLE                               
    bool
    prompt "trace performance enable"
    depends on ACTIONS_TRACE
    default n  
    
config TRACE_USE_ROM_CODE                               
    bool
    prompt "trace use rom vsnprintf"
    depends on ACTIONS_TRACE
    default n   
    
config TRACE_TIME_FREFIX                               
    bool
    prompt "trace use timestamp prefix"
    depends on ACTIONS_TRACE
    default n                                
    
config CONSOLE_ACTIONS_INIT_PRIORITY                               
    int
    prompt "Actions Trace Init Priority"
    depends on ACTIONS_TRACE
    default 61 

config ACTS_RING_BUFFER
	bool
	prompt "Actions Ring Buffers Support"
	depends on ACTIONS_UTILS
	default n
	help
	Enable usage of actions ring buffers. This is similar to kernel ring buffer,
	except that it contains a device address and support arbitrary buffer size.
	For optimal performance, use buffer sizes that are a power of 2.

config ACTS_TRANSCODE
	bool
	prompt "Actions Transcode Support"
	depends on ACTIONS_UTILS
	default n
	help
	Enable usage of actsions Enable actions transcode.


source "lib/utils/source/stream/Kconfig"
source "lib/utils/source/iterator/Kconfig"
```
