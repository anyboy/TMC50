## drivers/hotplug/Kconfig
```kconfig
# Kconfig - Input device configuration options
#
#
# Copyright (c) 2017 Actions Semiconductor Co., Ltd
#
# SPDX-License-Identifier: Apache-2.0
#

config HOTPLUG_LINEIN_DETECT
	bool "Actions SoC linein detect driver"
	depends on SOC_FAMILY_ACTS
	default n
	help
	  Enable support for Actions SoC linein detect driver.

config HOTPLUG_LINEIN_DETECT_ADC_NAME
	string "ADC device name for linein detect"
	default "ADC_0"
	help
	  This option specifies the ADC device name for linein detect.

config HOTPLUG_LINEIN_DETECT_ADC_CHAN
	int "ADC channel number for linein detect"
	help
	  This option specifies the ADC channel number for linein detect.

config HOTPLUG_DC5V_DETECT
	bool "dc5v detect enable"
	default y
	help
	  usb dc5v detect enable.

config HOTPLUG_DC5V_WIO
	int "dc5v detect wio port"
	depends on HOTPLUG_DC5V_DETECT
	default 1
	help
	  usb dc5v detect wakeup io port.

config HOTPLUG_DC5V_LEVEL
	int "dc5v detect wio level"
	depends on HOTPLUG_DC5V_DETECT
	default 1
	help
	  usb dc5v detect wakeup io level.
```

## drivers/input/Kconfig
```kconfig
# Kconfig - Input device configuration options
#
#
# Copyright (c) 2017 Actions Semiconductor Co., Ltd
#
# SPDX-License-Identifier: Apache-2.0
#

menuconfig INPUT_DEV
	bool
	prompt "Input device drivers"
	default n
	help
	  Enable input device driver configuration

if INPUT_DEV
config SYS_LOG_INPUT_DEV_LEVEL
	int
	prompt "INPUT Device drivers log level"
	depends on SYS_LOG
	range 0 4
	default 0
	help
	  Sets log level for INPUT Device driver.

	  Levels are:
	  - 0 OFF, do not write
	  - 1 ERROR, only write SYS_LOG_ERR
	  - 2 WARNING, write SYS_LOG_WRN in addition to previous level
	  - 3 INFO, write SYS_LOG_INF in addition to previous levels
	  - 4 DEBUG, write SYS_LOG_DBG in addition to previous levels

config ENCODER_INPUT
	bool
	prompt "encoder ec11 device enable"
	default n
	help
		encoder ec11 device enable.

config ENCODER_NAME
	string "encoder ec11 device name"
	depends on ENCODER_INPUT
	default "encoder_ec11"
	help
		the name of choosed device.

config INPUT_DEV_ACTS_ADCKEY
	bool "Actions SoC adc keypad driver"
	depends on SOC_FAMILY_ACTS
	default n
	help
	  Enable support for Actions SoC adc keypad driver.

config INPUT_DEV_ACTS_ADCKEY_NAME
	string "Device Name for Actions SoC adc keypad"
	depends on INPUT_DEV_ACTS_ADCKEY
	default "adckey"
	help
	  Device name for Actions SoC ADC keypad.

config INPUT_DEV_ACTS_ADCKEY_ADC_NAME
	string "Device Name for Actions SoC adc keypad"
	depends on INPUT_DEV_ACTS_ADCKEY
	default "ADC_0"
	help
	  ADC device name for Actions SoC ADC keypad.

config INPUT_DEV_ACTS_ADCKEY_ADC_CHAN
	int "Device Name for Actions SoC adc keypad"
	depends on INPUT_DEV_ACTS_ADCKEY
	help
	  ADC channel number for Actions SoC ADC keypad.

config INPUT_DEV_ACTS_ONOFF_KEY
	bool "Actions SoC On/Off key driver"
	depends on SOC_FAMILY_ACTS
	default n
	help
	  Enable support for Actions SoC On/Off key driver.

config INPUT_DEV_ACTS_ONOFF_KEY_NAME
	string "Device Name for Actions SoC On/Off key keyboard"
	default "onoff_key"
	depends on INPUT_DEV_ACTS_ONOFF_KEY
	help
	  Device name for Actions SoC On/Off key keyboard.

config INPUT_DEV_ACTS_IRKEY
	bool "Actions SoC infrared keypad driver"
	depends on SOC_FAMILY_ACTS
	default n
	help
	  Enable support for Actions SoC infrared keypad driver.

config INPUT_DEV_ACTS_IRKEY_NAME
	string "Device Name for Actions SoC infrared keypad"
	depends on INPUT_DEV_ACTS_IRKEY
	default "irkey"
	help
	  Device name for Actions SoC infrared keypad.

config INPUT_DEV_ACTS_IRKEY_POLL_USERCODE
	bool "Actions SoC infrared keypad driver poll usercode"
	depends on SOC_FAMILY_ACTS
	depends on INPUT_DEV_ACTS_IRKEY
	default n
	help
	  Poll the usercode of infrared keypad, if usercode is incorrect,
	  it will report to the developer.

config INPUT_DEV_ACTS_IRKEY_CORRECT_USERCODE
	bool "Actions SoC infrared keypad driver correct usercode automatically"
	depends on SOC_FAMILY_ACTS
	depends on INPUT_DEV_ACTS_IRKEY
	depends on INPUT_DEV_ACTS_IRKEY_POLL_USERCODE
	default n
	help
	  Poll the usercode of infrared keypad, if usercode is incorrect,
	  it will report to the developer and correct usercode automatically.

config INPUT_DEV_ACTS_ADC_SR
	bool "Actions SoC adc SR(Sliding rheostat) driver"
	depends on SOC_FAMILY_ACTS
	default n
	help
	  Enable support for Actions SoC adc SR driver.

config INPUT_DEV_ACTS_ADC_SR_NAME
	string "Device Name for Actions SoC adc keypad"
	depends on INPUT_DEV_ACTS_ADC_SR
	default "adcsr_drv"
	help
	  Device name for Actions SoC adc SR.

config INPUT_DEV_ACTS_SR_ADC_NAME
	string "ADC Device Name for Actions SoC adc SR"
	depends on INPUT_DEV_ACTS_ADC_SR
	default "ADC_0"
	help
	  ADC device name for Actions SoC ADC SR.

endif # INPUT_DEV
```

## drivers/pwm/Kconfig.acts
```kconfig
# Kconfig - Actions SoC PWM configuration options
#
#
# Copyright (c) 2018 Actions Semiconductor Co., Ltd
#
# SPDX-License-Identifier: Apache-2.0
#

menuconfig PWM_ACTS
	bool "Actions SoC PWM driver"
	depends on PWM
	default n
	help
	  This option enables the PWM driver for Actions SoC.
	  Say y if you wish to use PWM port on Actions SoC.

if PWM_ACTS

config PWM_ACTS_DEV_NAME
	string "Actions SoC PWM Device Name"
	depends on PWM_ACTS
	default "PWM_0"
	help
	  Specify the device name for the Actions SoC PWM driver.

endif # PWM_ACTS
```

## drivers/random/Kconfig.acts
```kconfig
# Kconfig.acts - acts random generator driver configuration
#
# Copyright (c) 2016 ARM Ltd.
#
# SPDX-License-Identifier: Apache-2.0

menuconfig RANDOM_ACTS_TRNG
	bool "ACTS TRNG driver"
	depends on RANDOM_GENERATOR
	default n
	help
	  This option enables the true random number generator (TRNG)
	  driver based on the ACTS TRNG driver.
```

## drivers/spicache_profile/Kconfig
```kconfig
# Kconfig - Actions Bluetooth SoC platform configuration options

#
# Copyright (c) 2019 Actions Semiconductor Co., Ltd
#
# SPDX-License-Identifier: Apache-2.0
#

config SPICACHE_PROFILE
	bool "Enable SPI cache profile"
	default n
	help
	  Enable SPI cache profile for Andes SoC
```

## drivers/usb/Kconfig
```kconfig
# Kconfig - USB configuration options

#
# Copyright (c) 2016 Wind River Systems, Inc.
#
# SPDX-License-Identifier: Apache-2.0
#

menuconfig USB
	bool "USB"
	default n
	help
	  Enable USB drivers.

menuconfig USB_HOST
	bool "USB HOST"
	default n
	help
	  Enable USB host drivers.

source "drivers/usb/device/Kconfig"
source "drivers/usb/host/Kconfig"
source "drivers/usb/otg/Kconfig"
```

## drivers/usb/device/Kconfig
```kconfig
# Kconfig - USB device configuration options

#
# Copyright (c) 2016 Wind River Systems, Inc.
#
# SPDX-License-Identifier: Apache-2.0
#

if USB

config USB_DEVICE_DRIVER
	bool
	select USB_DEVICE_STACK
	default n

config USB_DW
	bool
	prompt "Designware USB Device Controller Driver"
	select USB_DEVICE_DRIVER
	default n
	help
	  Designware USB Device Controller Driver.

config USB_DW_IRQ_PRI
	int "DesignWare USB Driver Interrupt priority"
	depends on USB_DW
	help
	  USB interrupt priority.

config SYS_LOG_USB_DRIVER_LEVEL
	int
	prompt "USB driver log level"
	depends on SYS_LOG
	default 0
	help
	  Sets log level for USB driver

	  Levels are:

	  - 0 OFF, do not write

	  - 1 ERROR, only write SYS_LOG_ERR

	  - 2 WARNING, write SYS_LOG_WRN in addition to previous level

	  - 3 INFO, write SYS_LOG_INF in addition to previous levels

	  - 4 DEBUG, write SYS_LOG_DBG in addition to previous levels

config USB_AOTG_UDC
	bool
	prompt "Actions OTG USB Device Controller Driver"
	select USB_DEVICE_DRIVER
	default n
	help
	  Actions OTG USB Device Controller Driver.

config USB_AOTG_UDC_FS
	bool
	prompt "Actions OTG USB Device Controller (full-speed)"
	depends on USB_AOTG_UDC
	default n
	help
	  Actions OTG USB Device Controller Driver (full-speed).

config USB_AOTG_UDC_DMA
	bool
	prompt "Actions OTG USB Device Controller Driver DMA Support"
	depends on DMA && USB_AOTG_UDC
	default n
	help
	  Actions OTG USB Device Controller Driver DMA Support.

endif # USB
```

## drivers/usb/host/Kconfig
```kconfig
# Kconfig - USB host configuration options

#
# Copyright (c) 2016 Actions Corporation.
#
# SPDX-License-Identifier: Apache-2.0
#

if USB_HOST

config USB_HOST_DRIVER
	bool
	select USB_HOST_STACK
	default n

config SYS_LOG_USB_HOST_DRIVER_LEVEL
	int
	prompt "USB host driver log level"
	depends on SYS_LOG
	default 0
	help
	  Sets log level for USB host driver

	  Levels are:

	  - 0 OFF, do not write

	  - 1 ERROR, only write SYS_LOG_ERR

	  - 2 WARNING, write SYS_LOG_WRN in addition to previous level

	  - 3 INFO, write SYS_LOG_INF in addition to previous levels

	  - 4 DEBUG, write SYS_LOG_DBG in addition to previous levels

config USB_AOTG_HCD
	bool
	prompt "Actions OTG USB HOST Controller Driver"
	default n
	help
	  Actions OTG USB HOST Controller Driver.

endif # USB_HOST
```

## drivers/wifi/Kconfig
```kconfig
# Kconfig - MMC configuration options

#
# Copyright (c) 2015 Intel Corporation
#
# Licensed under the Apache License, Version 2.0 (the "License");
# you may not use this file except in compliance with the License.
# You may obtain a copy of the License at
#
#     http://www.apache.org/licenses/LICENSE-2.0
#
# Unless required by applicable law or agreed to in writing, software
# distributed under the License is distributed on an "AS IS" BASIS,
# WITHOUT WARRANTIES OR CONDITIONS OF ANY KIND, either express or implied.
# See the License for the specific language governing permissions and
# limitations under the License.
#

#
# WIFI options
#
menuconfig WIFI
	bool
	prompt "WIFI Drivers"
	default n
	help
	Enable WIFI Driver Configuration

config WIFI_AIRKISS
	bool "wifi driver airkiss support"
	depends on WIFI
	default n
	help
	Enable wifi airkiss support on the selected board

if WIFI

source "drivers/wifi/ssv6030p/Kconfig"
source "drivers/wifi/rtl8189ftv/Kconfig"

endif
```

## drivers/wifi/ssv6030p/Kconfig
```kconfig
# Kconfig - MMC configuration options

#
# Copyright (c) 2015 Intel Corporation
#
# Licensed under the Apache License, Version 2.0 (the "License");
# you may not use this file except in compliance with the License.
# You may obtain a copy of the License at
#
#     http://www.apache.org/licenses/LICENSE-2.0
#
# Unless required by applicable law or agreed to in writing, software
# distributed under the License is distributed on an "AS IS" BASIS,
# WITHOUT WARRANTIES OR CONDITIONS OF ANY KIND, either express or implied.
# See the License for the specific language governing permissions and
# limitations under the License.
#

#
# WIFI options
#

config WIFI_SSV6030P
	bool "SSV6030P wifi driver"
	depends on WIFI
	default n
	help
	Enable SSV6030P wifi support on the selected board

config WIFI_EXT_RX_INT
	bool "SSV6030P wifi used external rx interrutp"
	depends on WIFI_SSV6030P
	default n
	help
	Enable SSV6030P wifi used external rx interrutp

config WIFI_DCDC_MODE
	bool "SSV6030P wifi used dcdc or ldo mode"
	depends on WIFI_SSV6030P
	default y
	help
	Enable SSV6030P wifi used dcdc or ldo mode

config USE_ICOMM_LWIP
	bool "SSV6030P wifi use lwip"
	depends on WIFI
	default n
	help
	Enable USE_ICOMM_LWIP support on the selected board

config USE_WIFI_HEAP_MEM
	bool "use wifi heap memory pool"
	default n
	depends on WIFI
	help
	This determines whether use wifi heap memory pool.
```

## ext/actions/Kconfig
```kconfig
#
# Copyright (c) 2016 Intel Corporation
#
# SPDX-License-Identifier: Apache-2.0
#

menu "Actions sdk"

config ACTIONS_SDK
	bool
	prompt "Actions SDK Support"
	default n
	select ACTIONS_SDK_PORTING
	select ACTIONS_COMPONENT_FUNCTION
	select ACTIONS_LIBRARY
	select ACTIONS_EXTERNAL_LIBRARY
	select ACTIONS_UTILS
	select MEMOYR
	help
	  This option enables the Actions SDK FUNCTION.

choice
	prompt "Actions SDk Function Mode"
	default ACTIONS_SDK_FULL_MODE
	depends on ACTIONS_SDK
	help
	  Select Memory Manager Funciton to compile.

config ACTIONS_SDK_FULL_MODE
	bool
	prompt "Actions SDK Full Function Mode"
	select SYSTEM
	select BLUETOOTH
	select MEDIA
	select INPUT
	select AUDIO
	select DISPLAY
	select POWER
	select PROPERTY
	select PROPERTY_CACHE
	select STREAM
	select ESD_MANAGER
	select SYS_STANDBY
	#select PLAYTTS
	#select PLAYTTS_ACT
	#select PLAY_KEYTONE
	select ACTS_RING_BUFFER
	select DVFS
	select THREAD_TIMER
	select SYS_LOG
	select PRINTK
	select SYSTEM_SHELL
	select KERNEL_SHELL
	select INIT_STACKS
	select THREAD_MONITOR
	select OBJECT_TRACING
	select CPU_LOAD_STAT
	select CPU_LOAD_DEBUG
	select SECTION_OVERLAY
	select STACK_MONITOR
	select THREAD_STACK_INFO
	select SYS_IRQ_LOCK
	select SYS_IRQ_LOCK_EXCEPT_BT_CON
	select XSPI_NOR_AUTO_CHECK_RB
	select STACK_BACKTRACE
	select ASSERT
	select ALARM
	help
	  This option enables the Actions SDK Full FUNCTION Mode.

config ACTIONS_SDK_TINY_MODE
	bool
	prompt "Actions SDK Tiny Function Mode"
	select SYSTEM
	select PROPERTY
	select INIT_STACKS
	select THREAD_MONITOR
	select SYS_IRQ_LOCK
	select SYS_IRQ_LOCK_EXCEPT_BT_CON
	select XSPI_NOR_AUTO_CHECK_RB
	help
	  This option enables the Actions SDK Tiny FUNCTION mode.

endchoice

config USP
	bool
	prompt "actions usp protocol Support"
	default n
	help
	This option enables actions usp protocol Support.

config USP_DUPLEX
	bool
	prompt "actions usp protocol with duplex Support"
	depends on USP
	default n
	help
	This option enables actions usp protocol with duplex Support.

config USP_TEST
	bool
	prompt "actions usp test Support"
	depends on USP
	default n
	help
	This option enables actions usp test Support.

config BT_DONGLE_SERVICE
	bool
	prompt "Enable/Disable BT dongle service"
	depends on USP
	select STUB_DEV_UART
	default n
	help
	This option is used to enable/disable BT dongle service, which works with FS360 project.

source "ext/actions/component/Kconfig"

source "ext/actions/library/Kconfig"

source "ext/actions/porting/Kconfig"

source "ext/actions/external/Kconfig"

endmenu
```
