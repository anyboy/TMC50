## ext/actions/Kconfig.defconfig
```kconfig
#
# Copyright (c) 2016 Intel Corporation
#
# SPDX-License-Identifier: Apache-2.0
#

if ACTIONS_SDK

config CPU_TASK_BLOCK_STAT
	default y

config SYS_CLOCK_TICKS_PER_SEC
	default 500

config SOC_WKEN_ONOFF_LONG_PRESS_TIMER
	default 1000

config HEAP_MEM_POOL_SIZE
	default 0

config NUM_MBOX_ASYNC_MSGS
	default 20

config MESSAGE_DEBUG
	default y

config NUM_PIPE_ASYNC_MSGS
	default 0

config CONTROLLER_HIGH_PRIORITY
	default -15

config SYSTEM_WORKQUEUE_PRIORITY
	default -1

config MEDIASRV_PRIORITY
	default 3

config BTSRV_PRIORITY
	default 5

config MAIN_THREAD_PRIORITY
	default 6

config APP_PRIORITY
	default 10

config CONTROLLER_HIGH_STACKSIZE
	default 1768

config SYSTEM_WORKQUEUE_STACK_SIZE
	default 1280

config IDLE_STACK_SIZE
	default 512

config MEDIASRV_STACKSIZE
	default 1920

config MAIN_STACK_SIZE
	default 1536

config APP_STACKSIZE
	default 1792

config BTSRV_STACKSIZE
	default 1536

config CONSOLE_SHELL_STACKSIZE
	default 1024

config ISR_STACK_SIZE
	default 2048

config TRACE_EVENT_BUFFERSIZE
	default 4096

config BT_ATT_PREPARE_COUNT
	default 2

config BT_RX_BUF_LEN
	default 680

config BT_L2CAP_RX_MTU
	default 672

config BT_L2CAP_TX_BUF_COUNT
	default 10

config BT_L2CAP_TX_MTU
	default 672

config BT_RX_STACK_SIZE
	default 1536

config BT_HCI_TX_STACK_SIZE
	default 1024

config BT_HCI_ACL_FLOW_CONTROL
	default n

config BT_ATT_ENFORCE_FLOW
	default n

config BT_TWS_US281B
	default y

# USB device stack
if USB
config USB_COMPOSITE_DEVICE_CLASS_NUM
	default 2

config USB_REQUEST_BUFFER_SIZE
	default 64

config SYS_LOG_USB_DEVICE_LEVEL
	default 4

config SYS_LOG_USB_DRIVER_LEVEL
	default 4

config USB_DEVICE_STRING_DESC_MAX_LEN
	default 30

# USB app (audio & hid) layer
config USB_APP_AUDIO_DEVICE_VID
	default 0x10d6

config USB_APP_AUDIO_DEVICE_PID
	default 0xb011

config USB_APP_AUDIO_DEVICE_MANUFACTURER
	default "Actions"

config USB_APP_AUDIO_DEVICE_PRODUCT
	default "USB Audio & HID"

config USB_APP_AUDIO_DEVICE_SN
	default "0123456789AB"
endif # USB

# USB device class: stub
if USB_DEVICE_STUB
config SYS_LOG_USB_STUB_LEVEL
	default 1

config STUB_IN_EP_ADDR
	default 0x81

config STUB_OUT_EP_ADDR
	default 0x02

config STUB_EP_MPS
	default 64

config USB_STUB_DEVICE_MANUFACTURER
	default "Actions"

config USB_STUB_DEVICE_PRODUCT
	default "USB-Stub-Dev"

config USB_STUB_DEVICE_SN
	default "ACTIONS-STUB-000"
endif # USB_DEVICE_STUB

# USB device class: hid
if USB_DEVICE_HID
config USB_HID_DEVICE_IF_NUM
	default 0

config HID_INTERRUPT_IN_EP_ADDR
	default 0x81

config HID_INTERRUPT_IN_EP_MPS
	default 64

config HID_INTERRUPT_OUT
	default y

config HID_INTERRUPT_OUT_EP_ADDR
	default 0x01

config HID_INTERRUPT_OUT_EP_MPS
	default 64

config HID_INTERRUPT_EP_INTERVAL_HS
	default 0x04

config HID_INTERRUPT_EP_INTERVAL_FS
	default 0x01

config HID_REPORT_DESC_SIZE
	default 192

endif # USB_DEVICE_HID

# USB device class: cdc

if USB_CDC_ACM

config CDC_ACM_DESC_STATIC
	default n

config UART_LINE_CTRL
	default y

config SYS_LOG_USB_CDC_ACM_LEVEL
	default 4

config  USB_CDC_ACM_MANUFACTURER
	default "Actions"

config USB_CDC_ACM_PRODUCT
	default "CDC-ACM"

config USB_CDC_ACM_SN
	default "0123456789A"

endif # USB_CDC_ACM

# USB device class: audio
if USB_AUDIO_CLASS
config USB_AUDIO_DEVICE_IF_NUM
	default 1

config USB_AUDIO_DEVICE_MANUFACTURER
	default "Actions"

config USB_AUDIO_DEVICE_PRODUCT
	default "USB Audio & HID"

config USB_AUDIO_DEVICE_SN
	default "0123456789AB"

config USB_AUDIO_SOURCE_IN_EP_ADDR
	default 0x82

config USB_AUDIO_UPLOAD_CHANNEL_NUM
	default 1

config USB_AUDIO_SINK_OUT_EP_ADDR
	default 0x02

config USB_AUDIO_DOWNLOAD_CHANNEL_NUM
	default 2

config USB_AUDIO_SINK_SAMPLE_FREQ_TYPE
	default 1

config USB_AUDIO_SINK_RESOLUTION
	default 16

config USB_AUDIO_CONTROL_UNIT
	default y

config SUPPORT_HD_AUDIO_PLAY
	default n

config SUPPORT_USB_AUDIO_SOURCE
	default n

config USB_AUDIO_SINK_MAINCH_CONFIG
	default 0x01

config USB_AUDIO_SINK_LOGICALCH01_CONFIG
	default 0x02

config USB_AUDIO_SINK_LOGICALCH02_CONFIG
	default 0x02
endif # USB_AUDIO_CLASS

# USB device class: msc
if USB_MASS_STORAGE
config USB_MASS_STORAGE_SHARE_THREAD
	default y

config MASS_STORAGE_DISK_NAME
	default "SD"

config MASS_STORAGE_DISK_PDRV
	default 4

config MASS_STORAGE_IN_EP_ADDR
	default 0x81

config MASS_STORAGE_OUT_EP_ADDR
	default 0x02

config SYS_LOG_USB_MASS_STORAGE_LEVEL
	default 3
endif # USB_MASS_STORAGE

# USB host stack
if USB_HOST
config SYS_LOG_USB_HOST_LEVEL
	default 3
endif # USB_HOST

# USB host storage diskio
config DISK_ACCESS_USB
	default y

if LEFT_CHANNEL_MUTE || RIGHT_CHANNEL_MUTE
config MEDIA_EFFECT_OUTMODE
	default 2
endif

endif
```

## ext/actions/component/Kconfig
```kconfig
# Kconfig - Actions component function

#
# Copyright (c) 2016 Actions Corporation
#
# SPDX-License-Identifier: Apache-2.0
#

menuconfig ACTIONS_COMPONENT_FUNCTION
	bool
	prompt "Actions Component Support"
	default n
	help
	This option enables actions app funcion.

source "ext/actions/component/audio/Kconfig"
source "ext/actions/component/input/Kconfig"
source "ext/actions/component/hotplug/Kconfig"
source "ext/actions/component/media/Kconfig"
source "ext/actions/component/power/Kconfig"
source "ext/actions/component/property/Kconfig"
source "ext/actions/component/system/Kconfig"
source "ext/actions/component/bt_manager/Kconfig"
source "ext/actions/component/tts/Kconfig"
source "ext/actions/component/fs_manager/Kconfig"
source "ext/actions/component/display/Kconfig"
source "ext/actions/component/serialwriter/Kconfig"
source "ext/actions/component/network/Kconfig"
source "ext/actions/component/alarm_manager/Kconfig"
source "ext/actions/component/fm/Kconfig"
```

## ext/actions/component/audio/Kconfig
```kconfig
# Kconfig - Actions audio

#
# Copyright (c) 2016 Actions Corporation
#
# SPDX-License-Identifier: Apache-2.0
#

menuconfig AUDIO
	bool
	prompt "Audio"
	depends on ACTIONS_COMPONENT_FUNCTION
	select VOLUEM_MANAGER
	default n
	help
	This option enables actions audio
	
config VOLUEM_MANAGER
	bool
	prompt "actions volume manager"
	depends on AUDIO
	default n
	help
	This option enables actions actions volume manager.
```

## ext/actions/component/bt_manager/Kconfig
```kconfig
# Kconfig - ACTIONS primitive options for sdk version 2.0

#
# Copyright (c) 2015 Intel Corporation
#
# Licensed under the Apache License, Version 2.0 (the "License");
# you may not use this file except in compliance with the License.
# You may obtain a copy of the License at
#
#     http://www.apache.org/licenses/LICENSE-2.0
#
# Unless required by applicable law or agreed to in writing, software
# distributed under the License is distributed on an "AS IS" BASIS,
# WITHOUT WARRANTIES OR CONDITIONS OF ANY KIND, either express or implied.
# See the License for the specific language governing permissions and
# limitations under the License.
#

menuconfig BLUETOOTH
	bool
	prompt "BlueTooth"
	depends on ACTIONS_COMPONENT_FUNCTION
	default n
	select BT_MANAGER
	help
	This option enables actions bluetooth funcion.

config BT_MANAGER
    bool
    prompt "Bt Manager Support"
	depends on BLUETOOTH
	select BT_SERVICE
	select BT_STACK
	select BLUETOOTH_PORTING
	select ACTS_TRANSCODE
    default n
    help
    This option enables bt manager.

config BT_DOUBLE_PHONE
    bool
    prompt "Bt double phone Support"
	depends on BT_MANAGER
    default n
    help
    This option enables Bt double phone manager.

config BT_DOUBLE_PHONE_EXT_MODE
    bool
    prompt "Bt double phone ext mode Support"
	depends on BT_DOUBLE_PHONE
    default n
    help
    This option enables Bt double phone ext mode Support.

config BT_DOUBLE_PHONE_PREEMPTION_MODE
    bool
    prompt "Bt double phone preemption mode Support"
	depends on BT_DOUBLE_PHONE
    default n
    help
    This option enables Bt double phone preemption mode Support.



config BT_BLE
    bool
    prompt "Bt Ble Support"
	depends on BT_MANAGER
	depends on BT_LE_ATT
    default n
    help
    This option enables bt manager.


config BT_A2DP_AAC
    bool
    prompt "Bt a2dp aac Support"
	depends on BT_MANAGER
    default n
    help
    This option enables bt a2dp aac .

config BT_A2DP_MAX_BITPOOL
    int
    prompt "Bt a2dp bit pool config"
	depends on BT_A2DP
    default 53
    help
    This option enables bt a2dp bit pool .

config BT_DEV_NAME
    string
    prompt "bt device name"
    depends on BT_MANAGER
    help
    This option specifies bt device classic name

config TWS
    bool
    prompt "bt manager Support tws"
	depends on BT_MANAGER
    default n
    help
    This option enables bt tws.

config TWS_MONO_MODE
    bool
    prompt "bt manager Support tws mono mode"
	depends on TWS
    default n
    help
    This option enables bt tws mono mode.

config TWS_BACKGROUND_BT
    bool
    prompt "bt manager Support local tws support background bt"
	depends on TWS
    default n
    help
    This option enables local tws support background bt.

config BT_HFP_TWS
    bool
    prompt "bt manager Support hfp tws"
	depends on TWS
    default n
    help
    This option enables bt hfp tws.
    
config CSB
    bool
    prompt "bt manager Support csb"
	depends on BT_MANAGER
    default n
    help
    This option enables bt csb.

config MGR_TEST_SAMPLE
    bool
    prompt "bt manager test sample"
	depends on BT_MANAGER
    default n
    help
    This option enables bt manager test sample.
```

## ext/actions/component/media/Kconfig
```kconfig
# Kconfig - Actions media player

#
# Copyright (c) 2016 Actions Corporation
#
# SPDX-License-Identifier: Apache-2.0
#

menuconfig MEDIA
	bool
	prompt "media"
	depends on ACTIONS_COMPONENT_FUNCTION
	select MEDIA_PLAYER
	default n
	help
	This option enables actions media

config MEDIA_PLAYER
	bool
	prompt "media player Support"
	depends on MEDIA
	select MEDIA_SERVICE
	select STREAM
	select RINGBUFF_STREAM
	default n
	help
	This option enables actions media player

config MEDIA_EFFECT
	bool
	prompt "media effect Support"
	depends on MEDIA_PLAYER
	default n
	help
	This option enables actions media effect

config MEDIA_EFFECT_OUTMODE
	int
	prompt "media effect output mode Support"
	depends on MEDIA_PLAYER
	default 0
	help
	This option enables actions media output mode 

config MUSIC_EFFECT
	bool
	prompt "music effect Support"
	depends on MEDIA_PLAYER
	select MEDIA_EFFECT
	select MUSIC_DAE
	select MUSIC_DAE_FADE
	default n
	help
	This option enables actions music effect

config MUSIC_DRC_EFFECT
	bool
	prompt "music drc effect Support"
	depends on MUSIC_EFFECT
	select MEDIA_EFFECT
	default n
	help
	This option enables actions music drc effect

config LCMUSIC_TWS_DRC_EFFECT
	bool
	prompt "music drc effect Support"
	depends on MUSIC_EFFECT
	select MEDIA_EFFECT
	default n
	help
	This option enables actions lcmusic music drc effect

config VOICE_EFFECT
	bool
	prompt "voice effect Support"
	depends on MEDIA_EFFECT
	default n
	help
	This option enables actions voice effect

config AEC_TAIL_LENGTH
	int
	prompt "AEC tail length config"
	default 48
	help
	This option set AEC tail length config

config TWS_A2DP_BITPOOL
	int
	prompt "local tws a2dp max bit pool"
	default 53
	help
	This option set local tws a2dp max bit pool
```

## ext/actions/component/network/Kconfig
```kconfig
# Kconfig - Actions network

#
# Copyright (c) 2016 Actions Corporation
#
# SPDX-License-Identifier: Apache-2.0
#

menuconfig NETWORK
	bool
	prompt "Network"
	depends on ACTIONS_COMPONENT_FUNCTION
	default n
	help
	This option enables actions network 

config WIFI_MANAGER
       bool
       prompt "wifi manager Support"
       depends on NETWORK
       default n
       help
       This option enables actions wifi manager
       
config CA_MANAGER
       bool
       prompt "ca manager Support"
       depends on NETWORK
       default n
       help
       This option enables actions ca manager

config NETWORK_HELPER
	bool
	prompt "net work helper Support"
	depends on NETWORK
	default n
	help
	This option enables actions net work helper for tcp http mqtt.

config TCP_HELPER
        bool
        prompt "tcp protocol helper "
		depends on NETWORK_HELPER
        default n
        help
        This option enables tcp protocol helper 

config HTTP_HELPER
        bool
        prompt "http protocol helper "
		depends on NETWORK_HELPER
        default y
        help
        This option enables http protocol helper 

config SOCKET_HELPER
        bool
        prompt "socket protocol helper "
		depends on NETWORK_HELPER
        default n
        help
        This option enables socket protocol helper

config DNS_HELPER
        bool
        prompt "dns protocol helper "
		depends on NETWORK_HELPER
        default n
        help
        This option enables dns protocol helper

config MQTT_HELPER
        bool
        prompt "mqtt protocol helper "
		depends on NETWORK_HELPER
        default n
        help
        This option enables mqtt protocol helper 

config WEBSOCKET_HELPER
        bool
        prompt "websocket protocol helper "
		depends on NETWORK_HELPER
        default n
        help
        This option enables websocket protocol helper

config TCP_KEEP_CONTEXT
        bool
        prompt "used tcp keep context, for create tcp link befor used"
		depends on HTTP_HELPER
        default n
        help
        This option enables used tcp keep context
```

## ext/actions/component/power/Kconfig
```kconfig
# Kconfig - Actions power manager

#
# Copyright (c) 2016 Actions Corporation
#
# SPDX-License-Identifier: Apache-2.0
#

menuconfig POWER
	bool
	prompt "Power"
	depends on ACTIONS_COMPONENT_FUNCTION
	select POWER_MANAGER
	default n
	help
	This option enables actions power 
	
config POWER_MANAGER
	bool
	prompt "power manager"
	depends on POWER
	default n
	help
	This option enables actions power manager.
```

## ext/actions/component/serialwriter/Kconfig
```kconfig
# Kconfig - Actions system manager

#
# Copyright (c) 2016 Actions Corporation
#
# SPDX-License-Identifier: Apache-2.0
#

config SERIALWIRTER
	bool
	prompt "Serial Writer"
	depends on ACTIONS_COMPONENT_FUNCTION
	default n
	help
	This option enables actions serial writer.
```
