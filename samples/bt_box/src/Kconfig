## samples/bt_box/src/Kconfig
```kconfig
# Kconfig - ACTIONS primitive options for sdk version 2.0

#
# Copyright (c) 2015 Intel Corporation
#
# Licensed under the Apache License, Version 2.0 (the "License");
# you may not use this file except in compliance with the License.
# You may obtain a copy of the License at
#
#     http://www.apache.org/licenses/LICENSE-2.0
#
# Unless required by applicable law or agreed to in writing, software
# distributed under the License is distributed on an "AS IS" BASIS,
# WITHOUT WARRANTIES OR CONDITIONS OF ANY KIND, either express or implied.
# See the License for the specific language governing permissions and
# limitations under the License.
#

menu "BT Box App"

source "samples/bt_box/src/Kconfig.def"

config APP_PRIORITY
    int
    prompt "App Thread Priority"
    default 10
    help
    This option set app thread priority

config APP_STACKSIZE
    int
    prompt "App Thread Stack Size"
    default 2048
    help
    This option set stack size for app thread

menu "App Configuration"

source "samples/bt_box/src/main/Kconfig"

source "samples/bt_box/src/btmusic/Kconfig"

source "samples/bt_box/src/btcall/Kconfig"

source "samples/bt_box/src/ota/Kconfig"

source "samples/bt_box/src/tws/Kconfig"

source "samples/bt_box/src/tool/Kconfig"

source "samples/bt_box/src/att/Kconfig"

source "samples/bt_box/src/ais_gma/Kconfig"

source "samples/bt_box/src/lcmusic/Kconfig"

source "samples/bt_box/src/local_player/Kconfig"

source "samples/bt_box/src/loop_music/Kconfig"

source "samples/bt_box/src/audio_input/Kconfig"

source "samples/bt_box/src/record/Kconfig"

source "samples/bt_box/src/record_service/Kconfig"

source "samples/bt_box/src/usound/Kconfig"

source "samples/bt_box/src/card_reader/Kconfig"

source "samples/bt_box/src/charger/Kconfig"

source "samples/bt_box/src/alarm/Kconfig"

source "samples/bt_box/src/fm/Kconfig"

source "samples/bt_box/src/aging_playback/Kconfig"

source "samples/bt_box/src/test/Kconfig"

endmenu

endmenu
```

## samples/bt_box/src/audio_input/Kconfig
```kconfig
# Kconfig - ACTIONS primitive options for sdk version 2.0

#
# Copyright (c) 2015 Intel Corporation
#
# Licensed under the Apache License, Version 2.0 (the "License");
# you may not use this file except in compliance with the License.
# You may obtain a copy of the License at
#
#     http://www.apache.org/licenses/LICENSE-2.0
#
# Unless required by applicable law or agreed to in writing, software
# distributed under the License is distributed on an "AS IS" BASIS,
# WITHOUT WARRANTIES OR CONDITIONS OF ANY KIND, either express or implied.
# See the License for the specific language governing permissions and
# limitations under the License.
#

config AUDIO_INPUT_APP
	bool
	prompt "Audio Input App Support"
	depends on MEDIA_PLAYER
	select STREAM
	select RINGBUFF_STREAM
	default n
	help
	This option enables or disable the audio input app.

config SPDIF_IN_APP
	bool
	prompt "Spdif In App Support"
	default n
	depends on AUDIO_INPUT_APP
	select OUTPUT_RESAMPLE
	select OUTPUT_RESAMPLE_SW
	help
	This option enables or disable the spdif in app.

config I2SRX_IN_APP
	bool
	prompt "i2srx In App Support"
	default n
	depends on AUDIO_INPUT_APP
	select AUDIO_IN_I2SRX0_SUPPORT
	select OUTPUT_RESAMPLE
	help
	This option enables or disable the i2srx in app.

config LINE_IN_APP
	bool
	prompt "Line In App Support"
	default n
	depends on AUDIO_INPUT_APP
	help
	This option enables or disable the line in app.


config MIC_IN_APP
	bool
	prompt "MIC In App Support"
	default n
	depends on AUDIO_INPUT_APP
	select OUTPUT_RESAMPLE
	help
	This option enables or disable the mic in app.

#soundbar audioin config
config SOUNDBAR_AUDIOIN_STAY
	bool
	prompt "Audio Input App Would Not Exit Even No Data"
	default n
	depends on AUDIO_INPUT_APP
	help
	This option enables or disable audioin app stays to wait for data
```

## samples/bt_box/src/main/Kconfig
```kconfig
# Kconfig - ACTIONS primitive options for sdk version 2.0

#
# Copyright (c) 2015 Intel Corporation
#
# Licensed under the Apache License, Version 2.0 (the "License");
# you may not use this file except in compliance with the License.
# You may obtain a copy of the License at
#
#     http://www.apache.org/licenses/LICENSE-2.0
#
# Unless required by applicable law or agreed to in writing, software
# distributed under the License is distributed on an "AS IS" BASIS,
# WITHOUT WARRANTIES OR CONDITIONS OF ANY KIND, either express or implied.
# See the License for the specific language governing permissions and
# limitations under the License.
#

config BT_MAIN_APP
	bool
	prompt "Btbox Main App Support"
	default n
	help
	This option enable or disable btbox main app

choice
	prompt "audio policy for output channel"
	default AUDIO_OUTPUT_DAC
	depends on BT_MAIN_APP
	help
	  Select audio policy for output channel

config AUDIO_OUTPUT_I2S
	bool
	prompt "output to i2s channel"
	select AUDIO_OUT_I2STX0_SUPPORT
	select OUTPUT_RESAMPLE
	help
	This option select audio output to i2s


config AUDIO_OUTPUT_DAC_AND_I2S
	bool
	prompt "output to i2s channel"
	select AUDIO_OUT_I2STX0_SUPPORT
	select OUTPUT_RESAMPLE
	help
	This option select audio output to i2s

config AUDIO_OUTPUT_SPDIF
	bool
	prompt "output to spdif channel"
	select AUDIO_OUT_SPDIFTX_SUPPORT
	select OUTPUT_RESAMPLE
	help
	This option select audio output to spidf tx

config AUDIO_OUTPUT_DAC
	bool
	prompt "output to dac channel"
	depends on BT_MAIN_APP
	help
	This option select audio output to dac
endchoice

config AUDIO_OUT_STEREO_ENABLE
	bool
	prompt "output to stereo dac channel"
	depends on BT_MAIN_APP
	help
	This option select audio output to dac

config AUDIO_OUT_LEFT_ONLY
	bool
	prompt "output to left dac channel"
	select RIGHT_CHANNEL_MUTE
	depends on BT_MAIN_APP
	help
	This option select audio output to dac

config AUDIO_OUT_RIGHT_ONLY
	bool
	prompt "output to right dac channel"
	select LEFT_CHANNEL_MUTE
	depends on BT_MAIN_APP
	help
	This option select audio output to dac

config OUTPUT_RESAMPLE
	bool
	prompt "allow resample out put rate"
	select RESAMPLE
	depends on MEDIA
	help
	This option select audio output to dac

config AUDIO_OUT_LEFT_RIGHT_SWAP
	bool
	prompt "output swap left/right dac channel"
	depends on AUDIO_OUT_STEREO_ENABLE
	default n
	help
	This option select audio output swap left/right dac

config TWS_AUDIO_OUT_MODE
	int
	prompt "tws audio output mode"
	default 0
	help
	This option select tws audio output mode

if AUDIO_OUT_LEFT_RIGHT_SWAP
config MEDIA_EFFECT_OUTMODE
	default 1
endif


config CONTROL_TTS_ENABLE
	bool
	prompt "control tts enable"
	depends on BT_MAIN_APP
	default n
	help
	This option select "control tts enable"


config LOW_LATENCY_MODE
	bool
	prompt "low latency mode"
	depends on BT_MAIN_APP
	select OS_LOW_LATENCY_MODE
	default n
	help
	This option enable low latency mode

config CASCADE
	bool
	prompt "cascade mode"
	default n
	help
	This option enable cascade mode
```

## samples/bt_box/src/tool/Kconfig
```kconfig
# Kconfig - ACTIONS primitive options for sdk version 2.0

#
# Copyright (c) 2015 Intel Corporation
#
# Licensed under the Apache License, Version 2.0 (the "License");
# you may not use this file except in compliance with the License.
# You may obtain a copy of the License at
#
#     http://www.apache.org/licenses/LICENSE-2.0
#
# Unless required by applicable law or agreed to in writing, software
# distributed under the License is distributed on an "AS IS" BASIS,
# WITHOUT WARRANTIES OR CONDITIONS OF ANY KIND, either express or implied.
# See the License for the specific language governing permissions and
# limitations under the License.
#

menuconfig TOOL
	bool "PC Tool Support"
	depends on STUB_DEV_USB
	default n
	help
	This option enables the PC TOOL

config TOOL_STACK_SIZE
	int "PC Tool thread stack size"
	depends on TOOL
	default 1536
	help
	This option configure PC Tool thread stack

config TOOL_ASET
	bool "PC TOOL ASET Support"
	depends on TOOL && MEDIA_SERVICE
	default n
	help
	This option enables the PC TOOL ASET

config TOOL_ASQT
	bool "PC TOOL ASQT Support"
	depends on TOOL && MEDIA_SERVICE
	default n
	select STREAM
	select ZERO_STREAM
	help
	This option enables the PC TOOL ASQT

config TOOL_ECTT
	bool "PC TOOL ECTT Support"
	depends on TOOL && MEDIA_SERVICE
	default n
	help
	This option enables the PC TOOL ECTT
```

## samples/bt_box/src/usound/Kconfig
```kconfig
# Kconfig - ACTIONS primitive options for sdk version 2.0

#
# Copyright (c) 2015 Intel Corporation
#
# Licensed under the Apache License, Version 2.0 (the "License");
# you may not use this file except in compliance with the License.
# You may obtain a copy of the License at
#
#     http://www.apache.org/licenses/LICENSE-2.0
#
# Unless required by applicable law or agreed to in writing, software
# distributed under the License is distributed on an "AS IS" BASIS,
# WITHOUT WARRANTIES OR CONDITIONS OF ANY KIND, either express or implied.
# See the License for the specific language governing permissions and
# limitations under the License.
#

config USOUND_APP
	bool
	prompt "USOUND App Support"
	depends on USB_AUDIO_SOURCESINK && USB_DEVICE_HID
	depends on  MEDIA_PLAYER
	select STREAM
	select RINGBUFF_STREAM
	default n
	help
	This option enables or disable the usb audio app.

config USOUND_SPEAKER
	bool
	prompt "USOUND IN"
	depends on USOUND_APP
	default n
	help
	This option enables or disable the usb audio in.

config USOUND_MIC
	bool
	prompt "USOUND OUT"
	depends on USOUND_APP
	select SUPPORT_USB_AUDIO_SOURCE 
	default n
	help
	This option enables or disable the usb audio out.
```

## subsys/btstack/Kconfig
```kconfig
menuconfig BTSTACK
	bool "BTstack support"
	default n
	help
	  This option enables the BTstack Bluetooth stack.

config BT_DEVICE_NAME
	string "Bluetooth device name"
	default "Zephyr"
	depends on BTSTACK
	help
	  Bluetooth device name. Name can be up to 248 bytes long (excluding
	  NULL termination). Can be empty string.

config BT_BLUEDROID
	bool "BT BLUEDROID support"
	default "Zephyr"
	depends on BTSTACK
	help
	 	This option enables the BTstack bluedroid.
```

## subsys/tracing/atrace/Kconfig
```kconfig
# Copyright (c) 2020 Actions Semiconductor Co., Ltd
# SPDX-License-Identifier: Apache-2.0

if TRACING_ATRACE

config TRACING_ATRACE_SHELL
	bool "Enable Actions trace shell"
	depends on TRACING_ATRACE
	default y
	help
	  Enable Actions trace shell for changing trace config dynamiclly.
endif
```
