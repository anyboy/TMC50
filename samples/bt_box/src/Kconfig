## subsys/usb/class/Kconfig
```kconfig
# Kconfig - USB class drivers configuration options

#
# Copyright (c) 2016 Wind River Systems, Inc.
#
# SPDX-License-Identifier: Apache-2.0
#

if USB_DEVICE_STACK

config USB_CDC_ACM
	bool "USB CDC ACM Device Class Driver"
	default n
	help
	  USB CDC ACM device class driver

config CDC_ACM_PORT_NAME
	string "CDC ACM class device driver port name"
	depends on USB_CDC_ACM
	default "CDC_ACM"
	help
	  Port name through which CDC ACM class device driver is accessed

config CDC_ACM_INTERRUPT_EP_ADDR
	hex "CDC ACM class interrupt IN endpoint address"
	depends on USB_CDC_ACM
	default 0x82
	range 0x81 0x8f
	help
	  CDC ACM class interrupt IN endpoint address

config CDC_ACM_INTERRUPT_EP_MPS
	int "CDC ACM class (full-speed) interrupt IN endpoint size"
	depends on USB_CDC_ACM
	default 16
	help
	  CDC ACM class full-speed interrupt IN endpoint size

config CDC_ACM_INTERRUPT_EP_INTERVAL
	hex "CDC ACM class (full-speed) interrupt IN endpoint interval"
	depends on USB_CDC_ACM
	default 0x0a
	range 0x01 0xff
	help
	  CDC ACM class full-speed interrupt IN endpoint interval

config CDC_ACM_HS_INTERRUPT_EP_INTERVAL
	hex "CDC ACM class (high-speed) interrupt IN endpoint interval"
	depends on USB_CDC_ACM
	default 0x6
	range 0x01 0x10
	help
	  CDC ACM class high-speed interrupt IN endpoint interval

config CDC_ACM_BULK_IN_EP_ADDR
	hex "CDC ACM class bulk IN endpoint address"
	depends on USB_CDC_ACM
	default 0x81
	range 0x81 0x8f
	help
	  CDC ACM class bulk IN endpoint address

config CDC_ACM_BULK_OUT_EP_ADDR
	hex "CDC ACM class bulk OUT endpoint address"
	depends on USB_CDC_ACM
	default 0x01
	range 0x01 0x0f
	help
	  CDC ACM class bulk OUT endpoint address

config CDC_ACM_BULK_EP_MPS
	int "CDC ACM class (full-speed) bulk endpoints size"
	depends on USB_CDC_ACM
	default 64
	range 8 64
	help
	  CDC ACM class full-speed bulk endpoints size

config SYS_LOG_USB_CDC_ACM_LEVEL
	int "USB CDC ACM device class driver log level"
	depends on USB_CDC_ACM && SYS_LOG
	default 0
	help
	  Sets log level for USB CDC ACM device class driver

	  Levels are:

	  - 0 OFF, do not write

	  - 1 ERROR, only write SYS_LOG_ERR

	  - 2 WARNING, write SYS_LOG_WRN in addition to previous level

	  - 3 INFO, write SYS_LOG_INF in addition to previous levels

	  - 4 DEBUG, write SYS_LOG_DBG in addition to previous levels

config USB_CDC_ACM_MANUFACTURER
	string
	prompt "USB cdc acm device manufacture string"
	default "ZEPHYR"
	help
	  USB cdc acm device manufacturer string, can be configured by vendor.

config USB_CDC_ACM_PRODUCT
	string
	prompt "usb cdc acm device product string"
	default "usb-cdc-acm"
	help
	  USB cdc acm device product string, can be configured by vendor.

config USB_CDC_ACM_SN
	string
	prompt "USB cdc acm device serial-number string"
	default "0.01"
	help
	  USB cdc acm device serial-number string, can be configured by vendor.

config USB_MASS_STORAGE
	bool
	prompt "USB Mass Storage Device Class Driver"
	depends on FAT_FILESYSTEM_ELM
	select DISK_ACCESS
	default n
	help
	  USB Mass Storage device class driver

config USB_MASS_STORAGE_SHARE_THREAD
	bool "USB Mass Storage thread is shared"
	depends on USB_MASS_STORAGE
	default n
	help
	  USB Mass Storage thread is shared

config MASS_STORAGE_DISK_NAME
	string "Mass storage disk or drive name"
	depends on USB_MASS_STORAGE
	default "NO_LUN"
	help
	  Mass storage device disk or drive name

config MASS_STORAGE_DISK_PDRV
	hex
	prompt "Mass storage disk or drive number"
	depends on USB_MASS_STORAGE
	default 0xff
	help
	  Mass storage device disk or drive number

	  pdrv numbers are:

	  - 0 NOR

	  - 1 NAND

	  - 2 PSRAM

	  - 3 USB

	  - 4 SD

	  - 5 RAM

	  - 0xff NO_LUN

config MASS_STORAGE_STACK_SIZE
	int "USB Mass Storage stack size"
	depends on USB_MASS_STORAGE
	default 1024
	help
	  USB Mass Storage stack size

config MASS_STORAGE_PRIORITY
	int "USB Mass Storage thread priority"
	depends on USB_MASS_STORAGE
	default -5
	help
	  USB Mass Storage thread priority

config MASS_STORAGE_BUF_SIZE
	int "USB Mass Storage buffer size"
	depends on USB_MASS_STORAGE
	default 512
	range 512 131072
	help
	  USB Mass Storage buffer size should be multiple of 512

config MASS_STORAGE_IN_EP_ADDR
	hex "Mass storage bulk IN endpoint size"
	depends on USB_MASS_STORAGE
	default 0x82
	range 0x81 0x8f
	help
	  Mass storage bulk IN endpoint size

config MASS_STORAGE_OUT_EP_ADDR
	hex "Mass storage bulk OUT endpoint address"
	depends on USB_MASS_STORAGE
	default 0x01
	range 0x01 0x0f
	help
	  Mass storage bulk OUT endpoint address

config MASS_STORAGE_BULK_EP_MPS
	int
	prompt "Mass storage full-speed bulk endpoints size"
	depends on USB_MASS_STORAGE
	default 64
	range 8 64
	help
	  Mass storage device class full-speed bulk endpoints size

config MASS_STORAGE_WP
	bool
	prompt "Mass storage write protect"
	depends on USB_MASS_STORAGE
	default n
	help
	  Enable Mass storage write protect

config MASS_STORAGE_SWITCH_TO_ADFU
	bool
	prompt "Mass storage switch to ADFU"
	depends on USB_MASS_STORAGE
	default y
	help
	  Enable Mass storage switch to ADFU

config SYS_LOG_USB_MASS_STORAGE_LEVEL
	int
	prompt "USB Mass Storage device class driver log level"
	depends on USB_MASS_STORAGE && SYS_LOG
	default 0
	help
	  Sets log level for USB Mass Storage device class driver

	  Levels are:

	  - 0 OFF, do not write

	  - 1 ERROR, only write SYS_LOG_ERR

	  - 2 WARNING, write SYS_LOG_WRN in addition to previous level

	  - 3 INFO, write SYS_LOG_INF in addition to previous levels

	  - 4 DEBUG, write SYS_LOG_DBG in addition to previous levels

config MASS_STORAGE_MANUFACTURER
	string
	prompt "USB Mass Storage device manufacturer string"
	depends on USB_MASS_STORAGE
	default "Actions"
	help
	  USB Mass Storage device manufacturer string

config MASS_STORAGE_PRODUCT
	string
	prompt "USB Mass Storage device product string"
	depends on USB_MASS_STORAGE
	default "MSC Sample"
	help
	  USB Mass Storage device product string

config MASS_STORAGE_SN
	string
	prompt "USB Mass Storage device serial number string"
	depends on USB_MASS_STORAGE
	default "0.01"
	help
	  USB Mass Storage device serial number string

config USB_DEVICE_BLUETOOTH
	bool
	prompt "USB Bluetooth Device Class Driver"
	select BT
	select BT_HCI_RAW
	default n
	help
	  USB Bluetooth device class driver

config BLUETOOTH_INT_EP_MPS
	int
	depends on USB_DEVICE_BLUETOOTH
	default 16
	range 8 64
	help
	  Bluetooth device class interrupt endpoint size

config BLUETOOTH_BULK_EP_MPS
	int
	depends on USB_DEVICE_BLUETOOTH
	default 64
	range 8 64
	help
	  Bluetooth device class bulk endpoint size

source "subsys/usb/class/netusb/Kconfig"

source "subsys/usb/class/hid/Kconfig"

source "subsys/usb/class/sourcesink/Kconfig"

source "subsys/usb/class/audio_sourcesink/Kconfig"

source "subsys/usb/class/stub/Kconfig"

config USB_DFU_CLASS
	bool
	prompt "USB DFU Class Driver"
	depends on IMG_MANAGER
	select MPU_ALLOW_FLASH_WRITE
	default n
	help
	  USB DFU class driver

config USB_DFU_MAX_XFER_SIZE
	int
	depends on USB_DFU_CLASS
	default 64

config USB_DFU_DETACH_TIMEOUT
	int
	depends on USB_DFU_CLASS
	default 1000

endif # CONFIG_USB_DEVICE_STACK
```

## subsys/usb/class/audio_sourcesink/Kconfig
```kconfig
# Kconfig - USB Audio Source configuration options

#
# Copyright (c) 2018 Actions Corp.
#
# SPDX-License-Identifier: Apache-2.0
#

if USB
config USB_AUDIO_CLASS
	bool

config USB_AUDIO_SOURCESINK
	bool
	prompt "USB Audio Source && Sink Device Support"
	default n
	select USB_AUDIO_CLASS
	help
	  Enables USB Audio Source && Sink Device Support.

if USB_AUDIO_SOURCESINK

config USB_AUDIO_DEVICE_MANUFACTURER
	string
	prompt "USB manufacturer name"
	default "ZEPHYR"
	help
	  USB audio device Manufacturer string. MUST be configured by vendor.

config USB_AUDIO_DEVICE_PRODUCT
	string
	prompt "USB product name"
	default "USB-AUDIO"
	help
	  USB audio device Product string. MUST be configured by vendor.

config USB_AUDIO_DEVICE_SN
	string
	prompt "USB serial number"
	default "0.01"
	help
	  USB audio device SerialNumber string. MUST be configured by vendor.

config USB_AUDIO_DEVICE_VID
	hex
	prompt "USB audio device vendor ID"
	default 0x10d6
	help
	  USB audio device vendor ID. MUST be configured by vendor.

config USB_AUDIO_DEVICE_PID
	hex
	prompt "USB audio device product ID"
	default 0xb00f
	help
	  USB audio device product ID. MUST be configured by vendor.

config USB_AUDIO_SOURCE_IN_EP_ADDR
	hex
	prompt "USB Audio Source In Endpoint Address"
	default 0x81
	range 0x81 0x8f
	help
	  USB Audio Source In Endpoint Address

config USB_AUDIO_SINK_OUT_EP_ADDR
	hex
	prompt "USB Audio Sink Out Endpoint address"
	default 0x01
	range 0x01 0x0f
	help
	  USB Audio Sink Out Endpoint address

config USB_AUDIO_SOURCE_SAM_FREQ_UPLOAD
	int
	prompt "USB Audio Source (1st) upload samplings frequency (unit: Hz)"
	default 48000
	help
	  USB Audio Source sampling frequency (unit: Hz)

config USB_AUDIO_SINK_SAM_FREQ_DOWNLOAD
	int
	prompt "USB Audio Sink (1st) download samplings frequency (unit: Hz)"
	default 48000
	help
	  USB Audio Sink sampling frequency (unit: Hz)

config USB_AUDIO_SINK_SAMPLE_FREQ_TYPE
	int
	prompt "USB Audio Sink sampling frequency type"
	default 1
	range 1 4
	help
	  USB Audio Sink sampling frequency type

config USB_AUDIO_UPLOAD_CHANNEL_NUM
	int
	prompt "USB Audio Source Channel number"
	default 1
	help
	  USB Audio Source Channel number

config USB_AUDIO_DOWNLOAD_CHANNEL_NUM
	int
	prompt "USB Audio Sink Channel number"
	default 2
	help
	  USB USB Audio Sink Channel number

config USB_AUDIO_SINK_MAINCH_CONFIG
	hex
	prompt "USB Audio Main Channel Configuration"
	default 0x03
	range 0x0000 0x03ff
	help
	  USB Audio Source channel config

config USB_AUDIO_SINK_LOGICALCH01_CONFIG
	hex
	prompt "USB Audio Logical Channel_01 Configuration"
	default 0x02
	range 0x0000 0x03ff
	help
	  USB Audio Logical channel_1 Configuration

config USB_AUDIO_SINK_LOGICALCH02_CONFIG
	hex
	prompt "USB Audio Logical Channel_02 Configuration"
	default 0x02
	range 0x0000 0x03ff
	help
	  USB Audio Logical channel_2 Configuration

config USB_AUDIO_BCONTROLSIZE
	int
	prompt "USB Audio Source resolution (unit: bit)"
	default 1
	range 1 2
	help
	  USB Audio Source resolution (unit: bit), The maximum value is 2

config USB_AUDIO_SINK_RESOLUTION
	int
	prompt "Size in bytes of Sampling bits of per sample"
	default 16
	help
	  Size in bytes of Sampling bits of per sample

config SUPPORT_HD_AUDIO_PLAY
	bool
	prompt "Support HD audio playback"
	default n
	help
	  Support HD audio playback.

if SUPPORT_HD_AUDIO_PLAY

config USB_AUDIO_SINK_HD_RESOLUTION
	int
	prompt "Size in bytes of Sampling bits of per sample"
	default 24
	help
	  Size in bytes of Sampling bits of per sample

config USB_AUDIO_SINK_HD_SAM_FREQ_DOWNLOAD
	int
	prompt "USB Audio Sink HD-Format Download Samplings Frequency (unit: Hz)"
	default 96000
	help
	  HD-Format Download Samplings Frequency (unit: Hz)

endif #CONFIG_SUPPORT_HD_AUDIO_PLAY

config SUPPORT_USB_AUDIO_SOURCE
	bool
	prompt "Support USB audio source(Microphone)"
	default n
	help
	  Support USB audio source(Microphone).

config USB_AUDIO_DEVICE_IF_NUM
	int
	prompt "Interface number of usb composite device"
	default 0
	help
	  Interface number of usb composite device

config USB_AUDIO_CONTROL_UNIT
	bool
	prompt "Define usb audio control unit"
	default n
	help
	  Define usb audio control unit.

endif # USB_AUDIO_SOURCESINK
endif # USB
```

## subsys/usb/class/hid/Kconfig
```kconfig
# Kconfig - USB HID configuration options

#
# Copyright (c) 2018 Intel Corp.
#
# SPDX-License-Identifier: Apache-2.0
#

config USB_DEVICE_HID
	bool
	prompt "USB Human Interface Device support"
	default n
	help
	  Enables USB Human Interface Device support.

if USB_DEVICE_HID

config USB_HID_DEVICE_IF_NUM
	int
	prompt "Interface number of hid device"
	default 0
	help
	  Interface number of hid device

config HID_INTERRUPT_IN_EP_MPS
	int
	prompt "USB HID Device Interrupt IN Endpoint size"
	default 16
	help
	  USB HID Device interrupt endpoint size

config HID_INTERRUPT_IN_EP_ADDR
	hex
	prompt "USB HID Device Interrupt Endpoint address"
	default 0x81
	range 0x81 0x8f
	help
	  USB HID Device Interrupt Endpoint address

config USB_HID_MAX_PAYLOAD_SIZE
	int
	default 64
	help
	  Max allowed payload size over USB HID Class

config HID_INTERRUPT_OUT
	bool
	prompt "USB HID Device Interrupt OUT support"
	default n
	help
	  Enables USB HID Device Interrupt OUT support.

if HID_INTERRUPT_OUT

config HID_INTERRUPT_OUT_EP_MPS
	int
	prompt "USB HID Device Interrupt OUT Endpoint size"
	default 16
	help
	  USB HID Device interrupt OUT endpoint size

config HID_INTERRUPT_OUT_EP_ADDR
	hex
	prompt "USB HID Device Interrupt OUT Endpoint address"
	default 0x01
	range 0x01 0x0f
	help
	  USB HID Device Interrupt OUT Endpoint address

endif # HID_INTERRUPT_OUT

config HID_INTERRUPT_EP_INTERVAL_HS
	hex
	prompt "USB HID Device Interrupt Interval in High-Speed Mode"
	default 0x4
	range 0x1 0xff
	help
	  USB HID Device Interrupt Interval in High-Speed Mode

config HID_INTERRUPT_EP_INTERVAL_FS
	hex
	prompt "USB HID Device Interrupt Interval in Full-Speed Mode"
	default 0x1
	range 0x1 0xff
	help
	  USB HID Device Interrupt Interval in Full-Speed Mode

config HID_INTERRUPT_EP_INTERVAL
	hex
	prompt "USB HID Device Interrupt Interval"
	default 0x1
	range 0x1 0xff
	help
	  USB HID Device Interrupt Interval

config USB_HID_DEVICE_MANUFACTURER
	string
	prompt "USB HID Device Manufacturer Name"
	default "USB-DEV_MA"
	help
		USB hid device manufacturer string. can be configured by vendor.

config USB_HID_DEVICE_PRODUCT
	string
	prompt "USB HID Device Product Name"
	default "USB-DEV_PR"
	help
		USB hid device product string. can be configured by vendor.

config USB_HID_DEVICE_SN
	string
	prompt "USB HID Device Serial Number"
	default "0123456789AB"
	help
		USB hid device serialNumber string. can be configured by vendor.

config USB_HID_DEVICE_VID
	hex
	prompt "USB hid device vendor ID"
	default 0x10d6
	help
	  USB hid device vendor ID. MUST be configured by vendor.

config USB_HID_DEVICE_PID
	hex
	prompt "USB hid device product ID"
	default 0xb00e
	help
	  USB hid device product ID. MUST be configured by vendor.

config HID_REPORT_DESC_SIZE
	int
	prompt "USB HID device hid report descriptor size"
	default 64
	help
	  USB HID device hid report descriptor size

endif # USB_DEVICE_HID
```

## subsys/usb/class/sourcesink/Kconfig
```kconfig
# Kconfig - USB Source/Sink configuration options

#
# Copyright (c) 2018 Actions Corp.
#
# SPDX-License-Identifier: Apache-2.0
#

config USB_DEVICE_SS
	bool
	prompt "USB Source/Sink Device support"
	default n
	help
	  Enables USB Source/Sink Device support.

if USB_DEVICE_SS

config SS_IN_EP_MPS
	int
	prompt "USB Source/Sink In Endpoint size"
	default 64
	help
	  USB Source/Sink In Endpoint size

config SS_IN_EP_ADDR
	hex
	prompt "USB Source/Sink In Endpoint address"
	default 0x81
	range 0x81 0x8f
	help
	  USB Source/Sink In Endpoint address

config SS_IN_EP_TYPE
	int
	prompt "USB Source/Sink In Endpoint type"
	default 2
	range 1 3
	help
	  USB Source/Sink In Endpoint type

	  types are:

	  - 1 Isochronous type endpoint

	  - 2 Bulk type endpoint

	  - 3 Interrupt type endpoint

config SS_IN_EP_INTERVAL
	int
	prompt "USB Source/Sink In Endpoint interval"
	default 0
	help
	  USB Source/Sink In Endpoint interval

config SS_OUT_EP_MPS
	int
	prompt "USB Source/Sink Out Endpoint size"
	default 64
	help
	  USB Source/Sink Out Endpoint size

config SS_OUT_EP_ADDR
	hex
	prompt "USB Source/Sink Out Endpoint address"
	default 0x01
	range 0x01 0x0f
	help
	  USB Source/Sink Out Endpoint address

config SS_OUT_EP_TYPE
	int
	prompt "USB Source/Sink Out Endpoint type"
	default 2
	range 1 3
	help
	  USB Source/Sink Out Endpoint type

	  types are:

	  - 1 Isochronous type endpoint

	  - 2 Bulk type endpoint

	  - 3 Interrupt type endpoint

config SS_OUT_EP_INTERVAL
	int
	prompt "USB Source/Sink Out Endpoint interval"
	default 0
	help
	  USB Source/Sink Out Endpoint interval

endif # USB_DEVICE_SS
```
